## APP_Framework/Applications/app_test/Kconfig
```kconfig
menu "test app"
    menuconfig USER_TEST
        bool "Enable application test function "
        default n

        if USER_TEST
            config USER_TEST_SPI_FLASH
                bool "Config test spi flash"
                default n

            menuconfig USER_TEST_ADC
                bool "Config test adc"
                default n
                if USER_TEST_ADC
                    if ADD_XIZI_FETURES
                        config ADC_DEV_DRIVER
                            string "Set ADC dev path"
                            default "/dev/adc1_dev"
                    endif
                endif

            menuconfig USER_TEST_DAC
                bool "Config test dac"
                default n
                if USER_TEST_DAC
                    if ADD_XIZI_FETURES
                        config DAC_DEV_DRIVER
                            string "Set DAC dev path"
                            default "/dev/dac_dev"
                    endif
                endif
        endif
endmenu
```

## APP_Framework/Applications/connection_app/Kconfig
```kconfig
menu "connection app"

    menuconfig APPLICATION_CONNECTION
        bool "Using connection apps"
        default n
	
endmenu
```

## APP_Framework/Applications/control_app/Kconfig
```kconfig
menu "control app"

    menuconfig APPLICATION_CONTROL
        bool "Using control apps"
        default n
        depends on SUPPORT_CONTROL_FRAMEWORK

endmenu
```

## APP_Framework/Applications/embedded_database_app/Kconfig
```kconfig
menuconfig USING_EMBEDDED_DATABASE_APP
    bool "embedded database app"
    default n
if USING_EMBEDDED_DATABASE_APP
        source "$APP_DIR/Applications/embedded_database_app/flashdb_app/Kconfig" 
endif
```

## APP_Framework/Applications/embedded_database_app/flashdb_app/Kconfig
```kconfig
config EMBEDDED_DATABASE_FLASHDB_APP
    bool "embedded database apps/flashdb(example)"
    select USING_EMBEDDED_DATABASE
    select USING_EMBEDDED_DATABASE_FLASHDB
    default n
```

## APP_Framework/Applications/knowing_app/Kconfig
```kconfig
menu "knowing app"
     menuconfig APPLICATION_KNOWING
        bool "Using knowing apps"
        default n
        
    if APPLICATION_KNOWING
        source "$APP_DIR/Applications/knowing_app/mnist/Kconfig" 
        source "$APP_DIR/Applications/knowing_app/k210_detect_entry/Kconfig" 
        source "$APP_DIR/Applications/knowing_app/iris_ml_demo/Kconfig" 
        source "$APP_DIR/Applications/knowing_app/k210_fft_test/Kconfig" 
        source "$APP_DIR/Applications/knowing_app/image_processing/Kconfig" 
        source "$APP_DIR/Applications/knowing_app/cmsis_5_demo/Kconfig"
        source "$APP_DIR/Applications/knowing_app/nnom_demo/Kconfig"  
 
    endif 
endmenu
```

## APP_Framework/Applications/knowing_app/cmsis_5_demo/Kconfig
```kconfig
menuconfig USING_CMSIS_5_DEMOAPP
        bool "CMSIS-5 demo app"
        depends on USING_CMSIS_5_NN
        default n

    if USING_CMSIS_5_DEMOAPP

        config USING_CMSIS_5_NN_DEMOAPP
            bool "Using CMSIS-5 NN demo app"
            select USING_IMAGE_PROCESSING
            select IMAGE_PROCESSING_USING_TJPGD
            default n

        config USING_CMSIS_5_NN_DEMOAPP_VEG_CLASSIFY
            bool "Using CMSIS-5 NN demo app vegetable classify"
            select USING_IMAGE_PROCESSING
            select IMAGE_PROCESSING_USING_TJPGD
            default n
    endif
```

## APP_Framework/Applications/knowing_app/image_processing/Kconfig
```kconfig
menuconfig USING_IMAGE_PROCESSING_APP
    bool "image processing app "
    default n
if USING_IMAGE_PROCESSING_APP
        source "$APP_DIR/Applications/knowing_app/image_processing/TJpgDec_APP/Kconfig" 
endif
```

## APP_Framework/Applications/knowing_app/image_processing/TJpgDec_APP/Kconfig
```kconfig
config IMAGE_PROCESSING_TJPGDEC_APP
    bool "image processing apps/TJpgDec(example)"
    select USING_IMAGE_PROCESSING
    select IMAGE_PROCESSING_USING_TJPGD
    default n
```

## APP_Framework/Applications/knowing_app/k210_detect_entry/Kconfig
```kconfig
config K210_DETECT_ENTRY
    bool "enable apps/k210 yolov2 detect entry"
    depends on BOARD_K210_EVB
	depends on DRV_USING_OV2640
	depends on USING_KPU_PROCESSING
	depends on USING_YOLOV2
	depends on USING_YOLOV2_JSONPARSER
	depends on USING_K210_YOLOV2_DETECT
    select LIB_USING_CJSON
    default n
```

## APP_Framework/Applications/knowing_app/mnist/Kconfig
```kconfig
config APP_MNIST
    bool "enable apps/mnist"
    depends on USING_TENSORFLOWLITEMICRO
    default n
```

## APP_Framework/Applications/knowing_app/nnom_demo/Kconfig
```kconfig
menuconfig USING_NNOM_DEMOAPP
        bool "NNOM demo app"
        depends on USING_NNOM
        default n

    if USING_NNOM_DEMOAPP

        config USING_NNOM_MNIST_DEMOAPP
            bool "Using NNOM mnist demo app"
            default n

    endif
```

## APP_Framework/Applications/ota/Kconfig
```kconfig
menu "ota app "
    menuconfig APPLICATION_OTA
        bool "Using app bin ota"
        default n


endmenu
```

## APP_Framework/Applications/sensor_app/Kconfig
```kconfig
menu "sensor app"

    menuconfig APPLICATION_SENSOR
        bool "Using sensor apps"
        default n

        if APPLICATION_SENSOR
            menuconfig APPLICATION_SENSOR_HCHO
                bool "Using sensor HCHO apps"
                default n

                if APPLICATION_SENSOR_HCHO
                    config APPLICATION_SENSOR_HCHO_TB600B_WQ_HCHO1OS
                    bool "Using sensor TB600B_WQ_HCHO1OS apps"
                    default n
                endif

            menuconfig APPLICATION_SENSOR_TVOC
                bool "Using sensor TVOC apps"
                default n

                if APPLICATION_SENSOR_TVOC
                    config APPLICATION_SENSOR_TVOC_TB600B_TVOC10
                    bool "Using sensor TB600B_TVOC10 apps"
                    default n
                endif

            menuconfig APPLICATION_SENSOR_IAQ
                bool "Using sensor IAQ apps"
                default n

                if APPLICATION_SENSOR_IAQ
                    config APPLICATION_SENSOR_IAQ_TB600B_IAQ10
                    bool "Using sensor TB600B_IAQ10 apps"
                    default n
                endif

            menuconfig APPLICATION_SENSOR_CH4
                bool "Using sensor CH4 apps"
                default n

                if APPLICATION_SENSOR_CH4
                    config APPLICATION_SENSOR_CH4_AS830
                    bool "Using sensor AS830 apps"
                    default n
                endif

            menuconfig APPLICATION_SENSOR_CO2
                bool "Using sensor CO2 apps"
                default n

                if APPLICATION_SENSOR_CO2
                    config APPLICATION_SENSOR_CO2_ZG09
                    bool "Using sensor ZG09 apps"
                    default n

                    config APPLICATION_SENSOR_CO2_G8S
                    bool "Using sensor G8S apps"
                    default n
                endif

            menuconfig APPLICATION_SENSOR_PM1_0
                bool "Using sensor PM1.0 apps"
                default n

                if APPLICATION_SENSOR_PM1_0
                    config APPLICATION_SENSOR_PM1_0_PS5308
                    bool "Using sensor PS5308 apps"
                    default n
                endif

            menuconfig APPLICATION_SENSOR_PM2_5
                bool "Using sensor PM2.5 apps"
                default n

                if APPLICATION_SENSOR_PM2_5
                    config APPLICATION_SENSOR_PM2_5_PS5308
                    bool "Using sensor PS5308 apps"
                    default n
                endif

            menuconfig APPLICATION_SENSOR_PM10
                bool "Using sensor PM10 apps"
                default n

                if APPLICATION_SENSOR_PM10
                    config APPLICATION_SENSOR_PM10_PS5308
                    bool "Using sensor PS5308 apps"
                    default n
                endif

            menuconfig APPLICATION_SENSOR_VOICE
                bool "Using sensor voice apps"
                default n

                if APPLICATION_SENSOR_VOICE
                    config APPLICATION_SENSOR_VOICE_D124
                    bool "Using sensor D124 apps"
                    default n
                endif

            menuconfig APPLICATION_SENSOR_TEMPERATURE
                bool "Using sensor temperature apps"
                default n

                if APPLICATION_SENSOR_TEMPERATURE
                    config APPLICATION_SENSOR_TEMPERATURE_HS300X
                    bool "Using sensor HS300x apps"
                    default n
                    
                    if ADD_NUTTX_FETURES
                    endif

                endif

            menuconfig APPLICATION_SENSOR_HUMIDITY
                bool "Using sensor humidity apps"
                default n

                if APPLICATION_SENSOR_HUMIDITY
                    config APPLICATION_SENSOR_HUMIDITY_HS300X
                    bool "Using sensor HS300x apps"
                    default n

                    if ADD_NUTTX_FETURES
                    endif

                endif
                
            menuconfig APPLICATION_SENSOR_WINDDIRECTION
                bool "Using sensor wind direction apps"
                default n

                if APPLICATION_SENSOR_WINDDIRECTION
                    config APPLICATION_SENSOR_WINDDIRECTION_QS_FX
                    bool "Using sensor QS-FX apps"
                    default n
                endif

            menuconfig APPLICATION_SENSOR_WINDSPEED
                bool "Using sensor wind speed apps"
                default n

                if APPLICATION_SENSOR_WINDSPEED
                    config APPLICATION_SENSOR_WINDSPEED_QS_FS
                    bool "Using sensor QS-FS apps"
                    default n
                endif

            menuconfig APPLICATION_SENSOR_ALTITUDE
                bool "Using sensor altitude apps"
                default n

                if APPLICATION_SENSOR_ALTITUDE
                    config APPLICATION_SENSOR_ALTITUDE_BMP180
                    bool "Using sensor BMP180 apps"
                    default n
                endif
        endif

endmenu
```

## APP_Framework/Framework/connection/4g/Kconfig
```kconfig
config ADAPTER_EC200T
        bool "Using 4G adapter device EC200T"
        default y

if ADAPTER_EC200T
    source "$APP_DIR/Framework/connection/4g/ec200t/Kconfig"
endif
                
```

## APP_Framework/Framework/connection/4g/ec200t/Kconfig
```kconfig
config ADAPTER_4G_EC200T
        string "EC200T adapter name"
        default "ec200t"

if ADD_XIZI_FETURES
        config ADAPTER_EC200T_PWRKEY
                int "EC200T PWRKEY pin number"
                default "97"

        config ADAPTER_EC200T_PIN_DRIVER
                string "EC200T device pin driver path"
                default "/dev/pin_dev"

        config ADAPTER_EC200T_DRIVER_EXTUART
                bool "Using extra uart to support 4G"
                default n

        config ADAPTER_EC200T_DRIVER
                string "EC200T device uart driver path"
                default "/dev/usart2_dev2"
                depends on !ADAPTER_EC200T_DRIVER_EXTUART

        if ADAPTER_EC200T_DRIVER_EXTUART                    
                config ADAPTER_EC200T_DRIVER
                        string "EC200T device extra uart driver path"
                        default "/dev/extuart_dev5"

                config ADAPTER_EC200T_DRIVER_EXT_PORT
                        int "if EC200T device using extuart, choose port"
                        default "5"
        endif
endif

if ADD_NUTTX_FETURES
        config ADAPTER_EC200T_DRIVER
                string "EC200T device uart driver path"
                default "/dev/ttyS8"

endif

if ADD_RTTHREAD_FETURES

endif
```

## APP_Framework/Framework/connection/Kconfig
```kconfig
menuconfig SUPPORT_CONNECTION_FRAMEWORK
        bool "support connection framework"
        default n
        select TRANSFORM_LAYER_ATTRIUBUTE

if SUPPORT_CONNECTION_FRAMEWORK
        config CONNECTION_FRAMEWORK_DEBUG
        bool "Using connection framework debug log function"
        default y

        menuconfig CONNECTION_INDUSTRIAL_ETHERNET
                bool "Using industrial ethernet"
                default n
        if CONNECTION_INDUSTRIAL_ETHERNET
        source "$APP_DIR/Framework/connection/industrial_ethernet/Kconfig"
        endif

        menuconfig CONNECTION_INDUSTRIAL_FIELDBUS
                bool "Using industrial fieldbus"
                default n
        if CONNECTION_INDUSTRIAL_FIELDBUS
        source "$APP_DIR/Framework/connection/industrial_fieldbus/Kconfig"
        endif

        menuconfig CONNECTION_INDUSTRIAL_WLAN
                bool "Using industrial wlan"
                default n
        if CONNECTION_INDUSTRIAL_WLAN
        source "$APP_DIR/Framework/connection/industrial_wlan/Kconfig"
        endif

        menuconfig CONNECTION_ADAPTER_LORA
                bool "Using lora adapter device"
                default n
        if CONNECTION_ADAPTER_LORA
        source "$APP_DIR/Framework/connection/lora/Kconfig"
        endif

        menuconfig CONNECTION_ADAPTER_4G
                bool "Using 4G adapter device"
                default n
        if CONNECTION_ADAPTER_4G
        source "$APP_DIR/Framework/connection/4g/Kconfig"
        endif

        menuconfig CONNECTION_ADAPTER_NB
                bool "Using nbiot adapter device"
                default n
        if CONNECTION_ADAPTER_NB
        source "$APP_DIR/Framework/connection/nbiot/Kconfig"
        endif

        menuconfig CONNECTION_ADAPTER_WIFI
                bool "Using wifi adapter device"
                default n
        if CONNECTION_ADAPTER_WIFI
        source "$APP_DIR/Framework/connection/wifi/Kconfig"
        endif

        menuconfig CONNECTION_ADAPTER_ETHERNET
                bool "Using ethernet adapter device"
                default n
        if CONNECTION_ADAPTER_ETHERNET
        source "$APP_DIR/Framework/connection/ethernet/Kconfig"
        endif

        menuconfig CONNECTION_ADAPTER_BLUETOOTH
                bool "Using bluetooth adapter device"
                default n
        if CONNECTION_ADAPTER_BLUETOOTH
        source "$APP_DIR/Framework/connection/bluetooth/Kconfig"
        endif

        menuconfig CONNECTION_ADAPTER_ZIGBEE
                bool "Using zigbee adapter device"
                default n
        if CONNECTION_ADAPTER_ZIGBEE
        source "$APP_DIR/Framework/connection/zigbee/Kconfig"
        endif

        menuconfig CONNECTION_ADAPTER_5G
                bool "Using 5G adapter device"
                default n
        if CONNECTION_ADAPTER_5G
        source "$APP_DIR/Framework/connection/5g/Kconfig"
        endif
endif
```

## APP_Framework/Framework/connection/bluetooth/Kconfig
```kconfig
config ADAPTER_HC08
        bool "Using bluetooth adapter device HC08"
        default y

if ADAPTER_HC08
    source "$APP_DIR/Framework/connection/bluetooth/hc08/Kconfig"
endif      
```
