## APP_Framework/Framework/connection/bluetooth/hc08/Kconfig
```kconfig
config ADAPTER_BLUETOOTH_HC08
        string "HC08 adapter name"
        default "hc08"

if ADD_XIZI_FETURES
        config ADAPTER_HC08_RECV_BUFFER_SIZE
                int "HC08 recv data buffer size"
                default "128"

        config ADAPTER_HC08_WORK_ROLE
                string "HC08 work role M(MASTER) or S(SLAVER)"
                default "M"
        
        config ADAPTER_HC08_DRIVER_EXTUART
                bool "Using extra uart to support bluetooth"
                default n

        config ADAPTER_HC08_DRIVER
                string "HC08 device uart driver path"
                default "/dev/uart4_dev4"
                depends on !ADAPTER_HC08_DRIVER_EXTUART

        if ADAPTER_HC08_DRIVER_EXTUART                    
                config ADAPTER_HC08_DRIVER
                        string "HC08 device extra uart driver path"
                        default "/dev/extuart_dev7"

                config ADAPTER_HC08_DRIVER_EXT_PORT
                        int "if HC08 device using extuart, choose port"
                        default "7"
        endif
endif

if ADD_NUTTX_FETURES

endif

if ADD_RTTHREAD_FETURES

endif
```

## APP_Framework/Framework/connection/ethernet/Kconfig
```kconfig
config ADAPTER_HFA21_ETHERNET
        help
            Please check HFA21 can only work for adapter_wifi or adapter_ethernet in the meantime!
        bool "Using ethernet adapter device HFA21"
        default n

if ADAPTER_HFA21_ETHERNET
    source "$APP_DIR/Framework/connection/ethernet/hfa21_ethernet/Kconfig"
endif
```

## APP_Framework/Framework/connection/industrial_ethernet/Kconfig
```kconfig
config CONNECTION_ADAPTER_ETHERCAT
    bool "Using ethercat on industrial_ethernet adapter device"
    default n

    if CONNECTION_ADAPTER_ETHERCAT
        source "$APP_DIR/Framework/connection/industrial_ethernet/ethercat/Kconfig"
    endif
```

## APP_Framework/Framework/connection/industrial_ethernet/ethercat/Kconfig
```kconfig
config ADAPTER_HFA21_ETHERCAT
        depends on ADAPTER_HFA21_ETHERNET # ADAPTER_HFA21_WIFI
        help
            Ethercat is dependant on Ethernet. Please enable hfa21 ethernet first. And this is a software-defined experiment module, without supports on ECS and on-the-fly.
        bool "Using ethercat on ethernet adapter device HFA21"
        default n

    if ADAPTER_HFA21_ETHERCAT
        source "$APP_DIR/Framework/connection/industrial_ethernet/ethercat/hfa21_ethercat/Kconfig"
    endif
```

## APP_Framework/Framework/connection/industrial_ethernet/ethercat/hfa21_ethercat/Kconfig
```kconfig
config ADAPTER_ETHERCAT_HFA21
        string "HFA21 EtherCAT adapter name"
        default "hfa21_ethercat"

config ADAPTER_ETHERCAT_HFA21_ROLE
        bool "support ethercat role configure"
        default y
        choice 
        prompt "EtherCAT adapter select net role type "
        default AS_ETHERCAT_SLAVE_ROLE

        config AS_ETHERCAT_MASTER_ROLE
                bool "config as a master"

        config AS_ETHERCAT_SLAVE_ROLE
                bool "config as a slave"
        endchoice


config ADAPTER_ETHERCAT_HFA21_NETMASK
        string "Current EtherCAT adapter netmask"
        default "255.255.255.0"

        
config ADAPTER_ETHERCAT_HFA21_GATEWAY
        string "Current EtherCAT adapter gateway"
        default "10.10.100.254"

config ADAPTER_ETHERCAT_HFA21_IP_SELF
        string "Current EtherCAT adapter IP"
        default "10.10.100.254"
        
config ADAPTER_ETHERCAT_ADDRESS_SELF
        string "Current EtherCAT address"
        default 0x12345678

config ADAPTER_ETHERCAT_HFA21_IP_FROM 
        string "Receive Packet from IP"
        default "10.10.100.50"

config ADAPTER_ETHERCAT_HFA21_IP_TO
        string "Send Packet to IP"
        default "10.10.100.50"
```
