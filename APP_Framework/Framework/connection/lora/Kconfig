## APP_Framework/Framework/connection/lora/Kconfig
```kconfig
config ADAPTER_SX1278
        bool "Using lora adapter device SX1278"
        default n

config ADAPTER_E220
        bool "Using lora adapter device E220-400T22S"
        default n

choice 
        prompt "Lora device adapter select net role type "
        default AS_LORA_CLIENT_ROLE

        config AS_LORA_GATEWAY_ROLE
                bool "config as a gateway"

        config AS_LORA_CLIENT_ROLE
                bool "config as a client"
endchoice

if AS_LORA_GATEWAY_ROLE
        config ADAPTER_LORA_NET_ROLE_ID
                hex "if Lora device config as a gateway, set gateway net id"
                default "0xFF"
endif

if AS_LORA_CLIENT_ROLE
        config ADAPTER_LORA_NET_ROLE_ID
                hex "if Lora device config as a client, set client net id"
                default "0x01"
endif

if ADAPTER_SX1278
    source "$APP_DIR/Framework/connection/lora/sx1278/Kconfig"
endif 

if ADAPTER_E220
    source "$APP_DIR/Framework/connection/lora/e220/Kconfig"
endif 
```

## APP_Framework/Framework/connection/lora/e220/Kconfig
```kconfig
config ADAPTER_LORA_E220
        string "E220-400T22S adapter name"
        default "e220"

if ADD_XIZI_FETURES
        config ADAPTER_E220_M0
                int "E220 M0 pin number"
                default "11"

        config ADAPTER_E220_M1
                int "E220 M1 pin number"
                default "9"

        config ADAPTER_E220_PIN_DRIVER
                string "E220 device pin driver path"
                default "/dev/pin_dev"
        
        config ADAPTER_E220_DRIVER_EXTUART
                bool "Using extra uart to support lora"
                default y

        config ADAPTER_E220_DRIVER
                string "E220 device uart driver path"
                default "/dev/uart1_dev1"
                depends on !ADAPTER_E220_DRIVER_EXTUART

        if ADAPTER_E220_DRIVER_EXTUART                    
                config ADAPTER_E220_DRIVER
                        string "E220 device extra uart driver path"
                        default "/dev/extuart_dev3"

                config ADAPTER_E220_DRIVER_EXT_PORT
                        int "if E220 device using extuart, choose port"
                        default "3"
        endif
endif

if ADD_NUTTX_FETURES

endif

if ADD_RTTHREAD_FETURES

endif
```

## APP_Framework/Framework/connection/lora/sx1278/Kconfig
```kconfig
config ADAPTER_LORA_SX1278
        string "SX1278 adapter name"
        default "sx1278"

if ADD_XIZI_FETURES
        config ADAPTER_SX1278_DRIVER
        string "SX1278 device spi driver path"
        default "/dev/spi2_lora"
endif

if ADD_NUTTX_FETURES
        config ADAPTER_SX1278_DRIVER
        string "SX1278 device spi driver path"
        default "/dev/spi2_lora"

endif

if ADD_RTTHREAD_FETURES

endif
```

## APP_Framework/Framework/connection/nbiot/Kconfig
```kconfig
if CONNECTION_ADAPTER_NB
    config ADAPTER_BC28
            bool "Using nbiot adapter device BC28"
            default y
    
    if ADAPTER_BC28
        source "$APP_DIR/Framework/connection/nbiot/bc28/Kconfig"
    endif
        
endif
```

## APP_Framework/Framework/connection/nbiot/bc28/Kconfig
```kconfig
config ADAPTER_NBIOT_BC28
        string "BC28 adapter name"
        default "bc28"

if ADD_XIZI_FETURES
        config ADAPTER_BC28_RESETPIN
                int "BC28 RESET pin number"
                default "100"

        config ADAPTER_BC28_PIN_DRIVER
                string "BC28 device pin driver path"
                default "/dev/pin_dev"

        config ADAPTER_BC28_DRIVER_EXTUART
                bool "Using extra uart to support nbiot"
                default n

        config ADAPTER_BC28_DRIVER
                string "BC28 device uart driver path"
                default "/dev/usart2_dev2"
                depends on !ADAPTER_BC28_DRIVER_EXTUART

        if ADAPTER_BC28_DRIVER_EXTUART                    
                config ADAPTER_BC28_DRIVER
                        string "BC28 device extra uart driver path"
                        default "/dev/extuart_dev5"

                config ADAPTER_BC28_DRIVER_EXT_PORT
                        int "if BC28 device using extuart, choose port"
                        default "5"
        endif
endif

if ADD_NUTTX_FETURES

endif

if ADD_RTTHREAD_FETURES

endif
```

## APP_Framework/Framework/connection/wifi/Kconfig
```kconfig
config ADAPTER_HFA21_WIFI
        help
            Please check HFA21 can only work for adapter_wifi or adapter_ethernet in the meantime!
        bool "Using wifi adapter device HFA21"
        default n

if ADAPTER_HFA21_WIFI
    source "$APP_DIR/Framework/connection/wifi/hfa21_wifi/Kconfig"
endif

config ADAPTER_ESP07S_WIFI
        bool "Using wifi adapter device esp07s"
        default n

if ADAPTER_ESP07S_WIFI
    source "$APP_DIR/Framework/connection/wifi/esp07s_wifi/Kconfig"
endif 
```

## APP_Framework/Framework/connection/wifi/esp07s_wifi/Kconfig
```kconfig
config ADAPTER_WIFI_ESP07S
        string "ESP07S WIFI adapter name"
        default "esp07s_wifi"

if ADD_XIZI_FETURES

        config ADAPTER_ESP07S_DRIVER_EXTUART
                bool "Using extra uart to support wifi"
                default n

        config ADAPTER_ESP07S_DRIVER
                string "ESP07S device uart driver path"
                default "/dev/uart2_dev2"
                depends on !ADAPTER_ESP07S_DRIVER_EXTUART

        if ADAPTER_ESP07S_DRIVER_EXTUART                    
                config ADAPTER_ESP07S_DRIVER
                        string "ESP07S device extra uart driver path"
                        default "/dev/extuart_dev6"

                config ADAPTER_ESP07S_DRIVER_EXT_PORT
                        int "if ESP07S device using extuart, choose port"
                        default "6"
        endif
endif

if ADD_NUTTX_FETURES

endif

if ADD_RTTHREAD_FETURES

endif
```

## APP_Framework/Framework/connection/wifi/hfa21_wifi/Kconfig
```kconfig
config ADAPTER_WIFI_HFA21
        string "HFA21 WIFI adapter name"
        default "hfa21_wifi"

if ADD_XIZI_FETURES

        config ADAPTER_HFA21_DRIVER_EXTUART
                bool "Using extra uart to support wifi"
                default n

        config ADAPTER_HFA21_DRIVER
                string "HFA21 device uart driver path"
                default "/dev/usart3_dev3"
                depends on !ADAPTER_HFA21_DRIVER_EXTUART

        if ADAPTER_HFA21_DRIVER_EXTUART                    
                config ADAPTER_HFA21_DRIVER
                        string "HFA21 device extra uart driver path"
                        default "/dev/extuart_dev6"

                config ADAPTER_HFA21_DRIVER_EXT_PORT
                        int "if HFA21 device using extuart, choose port"
                        default "6"
        endif
endif

if ADD_NUTTX_FETURES

endif

if ADD_RTTHREAD_FETURES

endif
```

## APP_Framework/Framework/connection/zigbee/Kconfig
```kconfig
if CONNECTION_ADAPTER_ZIGBEE
    config ADAPTER_E18
            bool "Using zigbee adapter device E18"
            default y
    
    if ADAPTER_E18
        source "$APP_DIR/Framework/connection/zigbee/e18/Kconfig"
    endif
        
endif
```

## APP_Framework/Framework/connection/zigbee/e18/Kconfig
```kconfig
config ADAPTER_ZIGBEE_E18
        string "E18 adapter name"
        default "e18"
        
choice 
        prompt "E18 adapter select net role type "
        default AS_END_DEVICE_ROLE

        config AS_COORDINATOR_ROLE
                bool "config as a coordinator"

        config AS_ROUTER_ROLE
                bool "config as a router"
        
        config AS_END_DEVICE_ROLE
                bool "config as an end device"
endchoice


if ADD_XIZI_FETURES
        config ADAPTER_E18_MODEPIN
                int "E18 MODE pin number"
                default "61"

        config ADAPTER_BC28_PIN_DRIVER
                string "BC28 device pin driver path"
                default "/dev/pin_dev"

        config ADAPTER_E18_DRIVER_EXTUART
                bool "Using extra uart to support zigbee"
                default n

        config ADAPTER_E18_DRIVER
                string "E18 device uart driver path"
                default "/dev/uart2_dev2"
                depends on !ADAPTER_E18_DRIVER_EXTUART

        if ADAPTER_E18_DRIVER_EXTUART                    
                config ADAPTER_E18_DRIVER
                        string "E18 device extra uart driver path"
                        default "/dev/extuart_dev0"

                config ADAPTER_E18_DRIVER_EXT_PORT
                        int "if E18 device using extuart, choose port"
                        default "0"
        endif
endif

if ADD_NUTTX_FETURES
    config ADAPTER_E18_DRIVER
            string "E18 device uart driver path"
            default "/dev/ttyS1"
           ---help---
               If USART1 is selected, then fill in /dev/ttyS1 here.
endif

if ADD_RTTHREAD_FETURES

endif
```

## APP_Framework/Framework/control/Kconfig
```kconfig
menuconfig SUPPORT_CONTROL_FRAMEWORK
    bool "support control framework"
    default n
    select TRANSFORM_LAYER_ATTRIUBUTE

if SUPPORT_CONTROL_FRAMEWORK
    source "$APP_DIR/Framework/control/plc/interoperability/Kconfig"
endif
```

## APP_Framework/Framework/control/plc/interoperability/socket/Kconfig
```kconfig
menuconfig USING_CONTROL_PLC_OPCUA
        bool "PLC support OPCUA"
        default y
        depends on RESOURCES_LWIP

menuconfig USING_CONTROL_PLC_SOCKET
        bool "PLC support SOCKET"
        default y
        depends on RESOURCES_LWIP
```

## APP_Framework/Framework/knowing/Kconfig
```kconfig
menuconfig SUPPORT_KNOWING_FRAMEWORK
        bool "support knowing framework"
        default n
        select TRANSFORM_LAYER_ATTRIUBUTE

if SUPPORT_KNOWING_FRAMEWORK
        source "$APP_DIR/Framework/knowing/tensorflow-lite/Kconfig"
        source "$APP_DIR/Framework/knowing/filter/Kconfig"
        source "$APP_DIR/Framework/knowing/ota/Kconfig"
        source "$APP_DIR/Framework/knowing/image_processing/Kconfig"
        source "$APP_DIR/Framework/knowing/cmsis_5/Kconfig"
        source "$APP_DIR/Framework/knowing/kpu/Kconfig"
        source "$APP_DIR/Framework/knowing/nnom/Kconfig"
endif
```

## APP_Framework/Framework/knowing/cmsis_5/Kconfig
```kconfig
menuconfig USING_CMSIS_5
    bool "CMSIS-5"
    default n

if USING_CMSIS_5

    menuconfig USING_CMSIS_5_NN
        bool "CMSIS-5 NN"
        default n

    if USING_CMSIS_5_NN
    
        config USING_CMSIS_5_NN_ACTIVATION
            bool "CMSIS-5 NN ACTIVATION"
            default y

        config USING_CMSIS_5_NN_CONVOLUTION
            bool "CMSIS-5 NN CONVOLUTION"
            default y

        config USING_CMSIS_5_NN_FULLY_CONNECTED
            bool "CMSIS-5 NN FULLY CONNECTED"
            default y

        config USING_CMSIS_5_NN_SUPPORT
            bool "CMSIS-5 NN SUPPORT"
            default y

        config USING_CMSIS_5_NN_POOLING
            bool "CMSIS-5 NN POOLING"
            default y

        config USING_CMSIS_5_NN_SOFTMAX
            bool "CMSIS-5 NN SOFTMAX"
            default y

    endif

endif
```

## APP_Framework/Framework/knowing/filter/Kconfig
```kconfig
menuconfig USING_KNOWING_FILTER
        bool "filters "
        default n

if USING_KNOWING_FILTER
        menuconfig USING_MEAN_FILTER
                bool "Using mean filter"
                default n
        if USING_MEAN_FILTER
        source "$APP_DIR/Framework/knowing/filter/mean_filter/Kconfig"
        endif

        menuconfig USING_KALMAN_FILTER
                bool "Using kalman filter"
                default n
        if USING_KALMAN_FILTER
        source "$APP_DIR/Framework/knowing/filter/kalman_filter/Kconfig"
        endif
        
        menuconfig USING_LOW_PASS_FILTER
                bool "Using low pass filter"
                default n
        if USING_LOW_PASS_FILTER
        source "$APP_DIR/Framework/knowing/filter/low_pass_filter/Kconfig"
        endif

        menuconfig USING_HIGH_PASS_FILTER
                bool "Using high pass filter"
                default n
        if USING_HIGH_PASS_FILTER
        source "$APP_DIR/Framework/knowing/filter/high_pass_filter/Kconfig"
        endif
        
endif
```

## APP_Framework/Framework/knowing/filter/high_pass_filter/Kconfig
```kconfig
config ONE_ORDER_RC_HIGH_PASS_FILTER
        bool "one order rc hpf"
        default n
```

## APP_Framework/Framework/knowing/filter/kalman_filter/Kconfig
```kconfig
config ONE_ORDER_KALMAN_FILTER
        bool "one order kalman filter"
        default n
```

## APP_Framework/Framework/knowing/filter/low_pass_filter/Kconfig
```kconfig
config ONE_ORDER_RC_LOW_PASS_FILTER
        bool "one order rc lpf"
        default n
```

## APP_Framework/Framework/knowing/filter/mean_filter/Kconfig
```kconfig
config SLIDING_WINDOW_MEAN_FILTER
        bool "sliding window mean filter"
        select LIB_USING_QUEUE
        default n

config ORDINARY_MEAN_FILTER
        bool "ordinary mean filter"
        default n
```

## APP_Framework/Framework/knowing/image_processing/Kconfig
```kconfig
menuconfig USING_IMAGE_PROCESSING
    bool "image processing "
    default n
if USING_IMAGE_PROCESSING
        source "$APP_DIR/Framework/knowing/image_processing/TJpgDec/Kconfig"
endif
```

## APP_Framework/Framework/knowing/image_processing/TJpgDec/Kconfig
```kconfig
menuconfig IMAGE_PROCESSING_USING_TJPGD
    bool "TJpgDec: Tiny JPEG Decompressor."
    default n

if IMAGE_PROCESSING_USING_TJPGD
        config TJPGD_INPUT_BUFFER_SIZE
                int "Size of stream input buffer"
                default 512
        choice
        prompt "Output format"
        default TJPGD_USING_FORMAT_RGB888
        help
                Select the RGB output format
        config TJPGD_USING_FORMAT_RGB888
                bool "RGB888"
        config TJPGD_USING_FORMAT_RGB565
                bool "RGB565"
        endchoice

        config TJPGD_USING_SCALE
                bool "Use output descaling"
                default y
                
        config TJPGD_USING_TBLCLIP
                bool "Use table for saturation"
                default y
endif
```

## APP_Framework/Framework/knowing/kpu/Kconfig
```kconfig
menuconfig USING_KPU_PROCESSING
    bool "kpu model processing"
    default y
if USING_KPU_PROCESSING
        source "$APP_DIR/Framework/knowing/kpu/yolov2/Kconfig"
        source "$APP_DIR/Framework/knowing/kpu/yolov2_json/Kconfig"
        source "$APP_DIR/Framework/knowing/kpu/k210_yolov2_detect_procedure/Kconfig"
endif
```

## APP_Framework/Framework/knowing/kpu/k210_yolov2_detect_procedure/Kconfig
```kconfig
menuconfig USING_K210_YOLOV2_DETECT
    bool "k210 yolov2 detect procedure"
	depends on USING_KPU_PROCESSING
    default n
```

## APP_Framework/Framework/knowing/kpu/yolov2/Kconfig
```kconfig
menuconfig USING_YOLOV2
    bool "yolov2 region layer"
	depends on USING_KPU_PROCESSING
    default n
```
