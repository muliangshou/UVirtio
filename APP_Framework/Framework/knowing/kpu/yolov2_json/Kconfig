## APP_Framework/Framework/knowing/kpu/yolov2_json/Kconfig
```kconfig
menuconfig USING_YOLOV2_JSONPARSER
    bool "yolov2 model json parser"
	depends on USING_KPU_PROCESSING
    default n
```

## APP_Framework/Framework/knowing/nnom/Kconfig
```kconfig
menuconfig USING_NNOM
    bool "NNOM"
    default n

if USING_NNOM

    config NNOM_USING_STATIC_MEMORY
        bool "Using static memory"
        default n
        help
        must set buf using "nnom_set_static_buf()" before creating a model. 

    config NNOM_TRUNCATE
        bool "Using NNOM Truncate"
        default n
        help
        disable: backend ops use round to the nearest int (default). enable: floor 
    
    choice
        prompt "Select NNOM Format"
        default NNOM_USING_HWC

        config NNOM_USING_HWC
            bool "Using HWC Format"

        config NNOM_USING_CHW
            bool "Using CHW Format"
            help
            CHW is incompatible with CMSIS-NN and must be used when using hardware accelerator such as KPU in K210 chip
    endchoice

    choice
        prompt "Select NNOM Backend"
        default USING_NNOM_NORMAL

        config NNOM_USING_LOCAL
            bool "Using NNOM local backend"

        config NNOM_USING_CMSIS_NN
            bool "Using CMSIS-NN backend"
            select  USING_CMSIS_5
            select  USING_CMSIS_5_NN
    endchoice

endif
```

## APP_Framework/Framework/knowing/ota/Kconfig
```kconfig
menuconfig USING_OTA_MODEL
    bool "OTA (KPU MODEL)"
    select PKG_USING_RW007
    default n
```

## APP_Framework/Framework/knowing/tensorflow-lite/Kconfig
```kconfig
menuconfig USING_TENSORFLOWLITEMICRO
    bool "Tensorflow Lite for Micro"
    select RT_USING_CPLUSPLUS
    select  LIB_CPLUSPLUS
    default n

if USING_TENSORFLOWLITEMICRO

    choice
        prompt "Select Tensorflow Lite Operators Type"
        default USING_TENSORFLOWLITEMICRO_NORMAL

        config USING_TENSORFLOWLITEMICRO_NORMAL
            bool "Using Tensorflow Lite normal operations"

        config USING_TENSORFLOWLITEMICRO_CMSISNN
            bool "Using Tensorflow Lite CMSIS NN operations"
    endchoice

    config USING_TENSORFLOWLITEMICRO_DEMOAPP
        bool "Using tensorflow lite for micro demo app"
        default n

endif
```

## APP_Framework/Framework/sensor/Kconfig
```kconfig
menuconfig SUPPORT_SENSOR_FRAMEWORK
        bool "support sensor framework"
        default n
        select TRANSFORM_LAYER_ATTRIUBUTE

if SUPPORT_SENSOR_FRAMEWORK
        menuconfig SENSOR_HCHO
                bool "Using HCHO sensor device"
                default n
        if SENSOR_HCHO
        source "$APP_DIR/Framework/sensor/hcho/Kconfig"
        endif

        menuconfig SENSOR_TVOC
                bool "Using TVOC sensor device"
                default n
        if SENSOR_TVOC
        source "$APP_DIR/Framework/sensor/tvoc/Kconfig"
        endif

        menuconfig SENSOR_IAQ
                bool "Using IAQ sensor device"
                default n
        if SENSOR_IAQ
        source "$APP_DIR/Framework/sensor/iaq/Kconfig"
        endif

        menuconfig SENSOR_CH4
                bool "Using Ch4 sensor device"
                default n
        if SENSOR_CH4
        source "$APP_DIR/Framework/sensor/ch4/Kconfig"
        endif

        menuconfig SENSOR_CO2
                bool "Using CO2 sensor device"
                default n
        if SENSOR_CO2
        source "$APP_DIR/Framework/sensor/co2/Kconfig"
        endif

        menuconfig SENSOR_PM
                bool "Using PM sensor device"
                default n
        if SENSOR_PM
        source "$APP_DIR/Framework/sensor/pm/Kconfig"
        endif

        menuconfig SENSOR_VOICE
                bool "Using voice sensor device"
                default n
        if SENSOR_VOICE
        source "$APP_DIR/Framework/sensor/voice/Kconfig"
        endif

        menuconfig SENSOR_TEMPERATURE
                bool "Using temperature sensor device"
                default n
        if SENSOR_TEMPERATURE
        source "$APP_DIR/Framework/sensor/temperature/Kconfig"
        endif

        menuconfig SENSOR_HUMIDITY
                bool "Using humidity sensor device"
                default n
        if SENSOR_HUMIDITY
        source "$APP_DIR/Framework/sensor/humidity/Kconfig"
        endif

        menuconfig SENSOR_WINDSPEED
                bool "Using wind speed sensor device"
                default n
        if SENSOR_WINDSPEED
        source "$APP_DIR/Framework/sensor/windspeed/Kconfig"
        endif

        menuconfig SENSOR_WINDDIRECTION
                bool "Using wind direction sensor device"
                default n
        if SENSOR_WINDDIRECTION
        source "$APP_DIR/Framework/sensor/winddirection/Kconfig"
        endif

        menuconfig SENSOR_ALTITUDE
                bool "Using altitude sensor device"
                default n
        if SENSOR_ALTITUDE
        source "$APP_DIR/Framework/sensor/altitude/Kconfig"
        endif
endif
```

## APP_Framework/Framework/sensor/altitude/Kconfig
```kconfig
config SENSOR_BMP180
        bool "Using BMP180"
        default n

        if SENSOR_BMP180
                config SENSOR_DEVICE_BMP180
                        string "BMP180 sensor name"
                        default "bmp180"
                
                config SENSOR_QUANTITY_BMP180_ALTITUDE
                        string "BMP180 quantity name"
                        default "altitude_1"
                
                if ADD_XIZI_FETURES
                        config SENSOR_DEVICE_BMP180_DEV
                                string "BMP180 device name"
                                default "/dev/i2c1_dev0"
                                
                        config SENSOR_DEVICE_BMP180_I2C_ADDR
                                hex "BMP180 device i2c address"
                                default 0x77
                endif

                if ADD_NUTTX_FETURES

                endif

                if ADD_RTTHREAD_FETURES

                endif
        endif
```

## APP_Framework/Framework/sensor/ch4/Kconfig
```kconfig
config SENSOR_AS830
        bool "Using as830"
        default n

        if SENSOR_AS830
                config SENSOR_DEVICE_AS830
                        string "as830 sensor name"
                        default "as830_1"
                
                config SENSOR_QUANTITY_AS830_CH4
                        string "as830 quantity name"
                        default "ch4_1"
                
                if ADD_XIZI_FETURES
                        config SENSOR_AS830_DRIVER_EXTUART
                                bool "Using extra uart to support as830"
                                default y

                        config SENSOR_DEVICE_AS830_DEV
                                string "as830 device uart path"
                                default "/dev/uart2_dev2"
                                depends on !SENSOR_AS830_DRIVER_EXTUART

                        if SENSOR_AS830_DRIVER_EXTUART
                                config SENSOR_DEVICE_AS830_DEV
                                        string "as830 device extra uart path"
                                        default "/dev/extuart_dev1"

                                config SENSOR_DEVICE_AS830_DEV_EXT_PORT
                                        int "if AS830 device using extuart, choose port"
                                        default "1"
                        endif
                endif

                if ADD_NUTTX_FETURES
                        config SENSOR_DEVICE_AS830_DEV
                                string "as830 device uart path"
                                default "/dev/ttyS1"
                               ---help---
                                   If USART1 is selected, then fill in /dev/ttyS1 here.

                endif

                if ADD_RTTHREAD_FETURES
                        config SENSOR_AS830_DRIVER_EXTUART
                                bool "Using extra uart to support as830"
                                default y

                        config SENSOR_DEVICE_AS830_DEV
                                string "as830 device uart path"
                                default "/dev/uart2"
                                depends on !SENSOR_AS830_DRIVER_EXTUART

                        if SENSOR_AS830_DRIVER_EXTUART
                                config SENSOR_DEVICE_AS830_DEV
                                        string "as830 device extra uart path"
                                        default "/dev/extuart_dev4"

                                config SENSOR_DEVICE_AS830_DEV_EXT_PORT
                                        int "if AS830 device using extuart, choose port"
                                        default "4"
                        endif
                endif                
        endif
```

## APP_Framework/Framework/sensor/co2/Kconfig
```kconfig
config SENSOR_ZG09
        bool "Using zg09"
        default n

        if SENSOR_ZG09
                config SENSOR_DEVICE_ZG09
                        string "zg09 sensor name"
                        default "zg09_1"
                
                config SENSOR_QUANTITY_ZG09_CO2
                        string "zg09 quantity name"
                        default "co2_1"
                
                if ADD_XIZI_FETURES
                        config SENSOR_ZG09_DRIVER_EXTUART
                                bool "Using extra uart to support zg09"
                                default y

                        config SENSOR_DEVICE_ZG09_DEV
                                string "zg09 device uart path"
                                default "/dev/uart2_dev2"
                                depends on !SENSOR_ZG09_DRIVER_EXTUART

                        if SENSOR_ZG09_DRIVER_EXTUART
                                config SENSOR_DEVICE_ZG09_DEV
                                        string "zg09 device extra uart path"
                                        default "/dev/extuart_dev4"

                                config SENSOR_DEVICE_ZG09_DEV_EXT_PORT
                                        int "if ZG09 device using extuart, choose port"
                                        default "4"
                        endif
                endif

                if ADD_NUTTX_FETURES
                       config SENSOR_DEVICE_ZG09_DEV
                               string "CO2 device name"
                               default "/dev/ttyS1"
                               ---help---
                                   If USART1 is selected, then fill in /dev/ttyS1 here.

                endif

                if ADD_RTTHREAD_FETURES
                        config SENSOR_ZG09_DRIVER_EXTUART
                                bool "Using extra uart to support zg09"
                                default y

                        config SENSOR_DEVICE_ZG09_DEV
                                string "zg09 device uart path"
                                default "/dev/uart2_dev2"
                                depends on !SENSOR_ZG09_DRIVER_EXTUART

                        if SENSOR_ZG09_DRIVER_EXTUART
                                config SENSOR_DEVICE_ZG09_DEV
                                        string "zg09 device extra uart path"
                                        default "/dev/extuart_dev4"

                                config SENSOR_DEVICE_ZG09_DEV_EXT_PORT
                                        int "if ZG09 device using extuart, choose port"
                                        default "4"
                        endif
                endif                
        endif

config SENSOR_G8S
        bool "Using g8-s"
        default n

        if SENSOR_G8S
                config SENSOR_DEVICE_G8S
                        string "g8-s sensor name"
                        default "g8-s"
                
                config SENSOR_QUANTITY_G8S_CO2
                        string "g8-s quantity name"
                        default "co2_2"
                
                if ADD_XIZI_FETURES
                        config SENSOR_G8S_DRIVER_EXTUART
                                bool "Using extra uart to support g8-s"
                                default n

                        config SENSOR_DEVICE_G8S_DEV
                                string "g8-s device uart path"
                                default "/dev/uart2_dev2"
                                depends on !SENSOR_G8S_DRIVER_EXTUART

                        if SENSOR_G8S_DRIVER_EXTUART
                                config SENSOR_DEVICE_G8S_DEV
                                        string "g8-s device extra uart path"
                                        default "/dev/extuart_dev4"

                                config SENSOR_DEVICE_G8S_DEV_EXT_PORT
                                        int "if g8-s device using extuart, choose port"
                                        default "4"
                        endif
                endif

                if ADD_NUTTX_FETURES

                endif

                if ADD_RTTHREAD_FETURES

                endif                
        endif
```
