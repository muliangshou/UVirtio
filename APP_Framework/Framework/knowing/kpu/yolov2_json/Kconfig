## APP_Framework/Framework/sensor/voice/Kconfig
```kconfig
config SENSOR_D124
        bool "Using D124"
        default n

        if SENSOR_D124
                config SENSOR_DEVICE_D124
                        string "D124 sensor name"
                        default "d124_1"
                
                config SENSOR_QUANTITY_D124_VOICE
                        string "D124 quantity voice name"
                        default "voice_1"
                
                if ADD_XIZI_FETURES
                        config SENSOR_D124_DRIVER_EXTUART
                                bool "Using extra uart to support D124"
                                default y

                        config SENSOR_DEVICE_D124_DEV
                                string "D124 device name"
                                default "/dev/uart2_dev2"
                                depends on !SENSOR_D124_DRIVER_EXTUART

                        if SENSOR_D124_DRIVER_EXTUART
                                config SENSOR_DEVICE_D124_DEV
                                        string "D124 device extra uart path"
                                        default "/dev/extuart_dev4"
                                
                                config SENSOR_DEVICE_D124_DEV_EXT_PORT
                                        int "if D124 device using extuart, choose port"
                                        default "4"
                        endif
                endif

                if ADD_NUTTX_FETURES
                       config SENSOR_DEVICE_D124_DEV
                               string "D124 device name"
                               default "/dev/ttyS1"
                               ---help---
                                   If USART1 is selected, then fill in /dev/ttyS1 here.

                endif

                if ADD_RTTHREAD_FETURES
                        config SENSOR_D124_DRIVER_EXTUART
                                bool "Using extra uart to support D124"
                                default y

                        config SENSOR_DEVICE_D124_DEV
                                string "D124 device name"
                                default "/dev/uart2_dev2"
                                depends on !SENSOR_D124_DRIVER_EXTUART

                        if SENSOR_D124_DRIVER_EXTUART
                                config SENSOR_DEVICE_D124_DEV
                                        string "D124 device extra uart path"
                                        default "/dev/extuart_dev4"
                                
                                config SENSOR_DEVICE_D124_DEV_EXT_PORT
                                        int "if D124 device using extuart, choose port"
                                        default "4"
                        endif
                endif
        endif
```

## APP_Framework/Framework/sensor/winddirection/Kconfig
```kconfig
config SENSOR_QS_FX
        bool "Using qs-fx wind direction sensor"
        default n

        if SENSOR_QS_FX
                config SENSOR_DEVICE_QS_FX
                        string "qs-fx sensor name"
                        default "qs_fx"
                
                config SENSOR_QUANTITY_QS_FX_WINDDIRECTION
                        string "qs-fx quantity name"
                        default "winddirection_1"
                
                if ADD_XIZI_FETURES
                        config SENSOR_QS_FX_DRIVER_EXTUART
                                bool "Using extra uart to support qs-fx"
                                default y

                        config SENSOR_DEVICE_QS_FX_DEV
                                string "qs-fx device name"
                                default "/dev/uart2_dev2"
                                depends on !SENSOR_QS_FX_DRIVER_EXTUART

                        if SENSOR_QS_FX_DRIVER_EXTUART
                                config SENSOR_DEVICE_QS_FX_DEV
                                        string "qs-fx device extra uart path"
                                        default "/dev/extuart_dev2"
                                
                                config SENSOR_DEVICE_QS_FX_DEV_EXT_PORT
                                        int "if qs-fx device using extuart, choose port"
                                        default "2"
                        endif
                endif

                if ADD_NUTTX_FETURES
                        config SENSOR_DEVICE_QS_FX_DEV
                                string "qs-fx device name"
                                default "/dev/ttyS1"
                               ---help---
                                   If USART1 is selected, then fill in /dev/ttyS1 here.

                endif

                if ADD_RTTHREAD_FETURES

                endif
        endif
```

## APP_Framework/Framework/sensor/windspeed/Kconfig
```kconfig
config SENSOR_QS_FS
        bool "Using qs-fs wind speed sensor"
        default n

        if SENSOR_QS_FS
                config SENSOR_DEVICE_QS_FS
                        string "qs-fs sensor name"
                        default "qs-fs"
                
                config SENSOR_QUANTITY_QS_FS_WINDSPEED
                        string "qs-fs quantity name"
                        default "windspeed_1"
                
                if ADD_XIZI_FETURES
                        config SENSOR_QS_FS_DRIVER_EXTUART
                                bool "Using extra uart to support qs-fx"
                                default y

                        config SENSOR_DEVICE_QS_FS_DEV
                                string "qs-fx device name"
                                default "/dev/uart2_dev2"
                                depends on !SENSOR_QS_FS_DRIVER_EXTUART

                        if SENSOR_QS_FS_DRIVER_EXTUART
                                config SENSOR_DEVICE_QS_FS_DEV
                                        string "qs-fx device extra uart path"
                                        default "/dev/extuart_dev7"
                                
                                config SENSOR_DEVICE_QS_FS_DEV_EXT_PORT
                                        int "if qs-fx device using extuart, choose port"
                                        default "7"
                        endif
                endif

                if ADD_NUTTX_FETURES
                        config SENSOR_DEVICE_QS_FS_DEV
                                string "qs-fx device name"
                                default "/dev/ttyS1"
                               ---help---
                                   If USART1 is selected, then fill in /dev/ttyS1 here.

                endif

                if ADD_RTTHREAD_FETURES

                endif
        endif
```

## APP_Framework/lib/Kconfig
```kconfig
menu "lib"
    choice
            prompt "chose a kind of lib for app"
            default APP_SELECT_NEWLIB

            config APP_SELECT_NEWLIB
                bool "app select newlib"

            config APP_SELECT_OTHER_LIB
                bool "app select other lib"
    endchoice
     source "$APP_DIR/lib/cJSON/Kconfig"
     source "$APP_DIR/lib/queue/Kconfig"
     source "$APP_DIR/lib/lvgl/Kconfig"
     source "$APP_DIR/lib/embedded_database/Kconfig"
endmenu
```

## APP_Framework/lib/embedded_database/Kconfig
```kconfig
menuconfig USING_EMBEDDED_DATABASE
    bool "embedded database"
    default n
if USING_EMBEDDED_DATABASE
        source "$APP_DIR/lib/embedded_database/flashdb/Kconfig"
endif
```

## APP_Framework/lib/embedded_database/flashdb/Kconfig
```kconfig
menuconfig USING_EMBEDDED_DATABASE_FLASHDB
    bool "flashdb an ultra-lightweight embedded database "
    default n

if USING_EMBEDDED_DATABASE_FLASHDB
    comment " fal io is not supported so far"
    choice
        prompt "select io mode"
        default FDB_USING_FILE_POSIX_MODE
        help
                Select io mode
        config FDB_USING_FILE_POSIX_MODE
                bool "file posix io "
        config FDB_USING_FILE_LIBC_MODE
                bool "file libc io "
        config FDB_USING_FAL_MODE
                bool "flash fal io "
    endchoice 
    config FDB_USING_KVDB
            bool "Use key value database"
            default n
    config FDB_USING_TSDB
            bool "Use time series database"
            default n
endif
```

## Ubiquitous/Nuttx_Fusion_XiUOS/aiit_board/xidatong/Kconfig
```kconfig
#
# For a description of the syntax of this configuration file,
# see the file kconfig-language.txt in the NuttX tools repository.
#

if ARCH_BOARD_XIDATONG

choice
	prompt "Boot Flash"
	default XIDATONG_QSPI_FLASH

config XIDATONG_HYPER_FLASH
	bool "HYPER Flash"

config XIDATONG_QSPI_FLASH
	bool "QSPI Flash"

endchoice # Boot Flash

config XIDATONG_SDRAM
	bool "Enable SDRAM"
	default y
	select IMXRT_SEMC_INIT_DONE
	---help---
		Activate DCD configuration of SDRAM

config XIDATONG_SDIO_AUTOMOUNT
  bool "SD card automounter"
  default n
  depends on FS_AUTOMOUNTER && IMXRT_USDHC

if XIDATONG_SDIO_AUTOMOUNT

config XIDATONG_SDIO_AUTOMOUNT_FSTYPE
  string "SD card file system type"
  default "vfat"

config XIDATONG_SDIO_AUTOMOUNT_BLKDEV
  string "SD card block device"
  default "/dev/mmcsd0"

config XIDATONG_SDIO_AUTOMOUNT_MOUNTPOINT
  string "SD card mount point"
  default "/mnt/sdcard"

config XIDATONG_SDIO_AUTOMOUNT_DDELAY
  int "SD card debounce delay (milliseconds)"
  default 1000

config XIDATONG_SDIO_AUTOMOUNT_UDELAY
  int "SD card unmount retry delay (milliseconds)"
  default 2000

endif # XIDATONG_SDIO_AUTOMOUNT

config XIDATONG_USB_AUTOMOUNT
	bool "USB Mass Storage automounter"
	default n
	depends on USBHOST_MSC && USBHOST_MSC_NOTIFIER

if XIDATONG_USB_AUTOMOUNT

config XIDATONG_USB_AUTOMOUNT_FSTYPE
	string "USB file system type"
	default "vfat"

config XIDATONG_USB_AUTOMOUNT_BLKDEV
	string "USB block device prefix"
	default "/dev/sd"

config XIDATONG_USB_AUTOMOUNT_MOUNTPOINT
	string "USB mount point prefix"
	default "/mnt/usb"

config XIDATONG_USB_AUTOMOUNT_NUM_BLKDEV
	int "Number of block devices to monitor."
	range 1 26
	default 4

config XIDATONG_USB_AUTOMOUNT_UDELAY
	int "USB unmount retry delay (milliseconds)"
	default 2000

endif # XIDATONG_USB_AUTOMOUNT


endif
```
