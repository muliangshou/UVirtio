## APP_Framework/Framework/sensor/hcho/Kconfig
```kconfig
config SENSOR_TB600B_WQ_HCHO1OS
        bool "Using TB600B WQ_HCHO1OS"
        default n

        if SENSOR_TB600B_WQ_HCHO1OS
                config SENSOR_DEVICE_TB600B_WQ_HCHO1OS
                        string "tb600b wq_hcho1os sensor name"
                        default "tb600b_wq_hcho1os_1"
                
                config SENSOR_QUANTITY_TB600B_HCHO
                        string "tb600b wq_hcho1os quantity name"
                        default "hcho_1"
                
                if ADD_XIZI_FETURES
                        config SENSOR_TB600B_WQ_HCHO1OS_DRIVER_EXTUART
                                bool "Using extra uart to support tb600b wq_hcho1os"
                                default y

                        config SENSOR_DEVICE_TB600B_WQ_HCHO1OS_DEV
                                string "tb600b wq_hcho1os device uart path"
                                default "/dev/uart2_dev2"
                                depends on !SENSOR_TB600B_WQ_HCHO1OS_DRIVER_EXTUART

                        if SENSOR_TB600B_WQ_HCHO1OS_DRIVER_EXTUART
                                config SENSOR_DEVICE_TB600B_WQ_HCHO1OS_DEV
                                        string "tb600b wq_hcho1os device extra uart path"
                                        default "/dev/extuart_dev5"

                                config SENSOR_DEVICE_TB600B_WQ_HCHO1OS_DEV_EXT_PORT
                                        int "if TB600B_WQ_HCHO1OS device using extuart, choose port"
                                        default "5"
                        endif
                endif

                if ADD_NUTTX_FETURES
                        config SENSOR_DEVICE_TB600B_WQ_HCHO1OS_DEV
                                string "tb600b wq_hcho1os device uart path"
                                default "/dev/ttyS1"
                               ---help---
                                   If USART1 is selected, then fill in /dev/ttyS1 here.

                endif

                if ADD_RTTHREAD_FETURES
                        config SENSOR_TB600B_WQ_HCHO1OS_DRIVER_EXTUART
                                bool "Using extra uart to support tb600b wq_hcho1os"
                                default y

                        config SENSOR_DEVICE_TB600B_WQ_HCHO1OS_DEV
                                string "tb600b wq_hcho1os device uart path"
                                default "/dev/uart2"
                                depends on !SENSOR_TB600B_WQ_HCHO1OS_DRIVER_EXTUART

                        if SENSOR_TB600B_WQ_HCHO1OS_DRIVER_EXTUART
                                config SENSOR_DEVICE_TB600B_WQ_HCHO1OS_DEV
                                        string "tb600b wq_hcho1os device extra uart path"
                                        default "/dev/extuart_dev1"

                                config SENSOR_DEVICE_TB600B_WQ_HCHO1OS_DEV_EXT_PORT
                                        int "if TB600B_WQ_HCHO1OS device using extuart, choose port"
                                        default "1"
                        endif
                endif                
        endif
```

## APP_Framework/Framework/sensor/humidity/Kconfig
```kconfig
config SENSOR_HS300X_HUMIDITY 
        bool "Using HS300x for humidity"
        default n

        if SENSOR_HS300X_HUMIDITY
                config SENSOR_DEVICE_HS300X
                        string "HS300x sensor name"
                        default "hs300x_1"
                
                config SENSOR_QUANTITY_HS300X_HUMIDITY
                        string "HS300x quantity name"
                        default "humidity_1"
                
                if ADD_XIZI_FETURES                
                        config SENSOR_DEVICE_HS300X_DEV
                                string "HS300x device name"
                                default "/dev/i2c1_dev0"
                        
                        config SENSOR_DEVICE_HS300X_I2C_ADDR
                                hex "HS300x device i2c address"
                                default 0x44
                endif


                if ADD_NUTTX_FETURES
                        config SENSOR_DEVICE_HS300X_DEV
                                string "HS300x device name"
                                default "/dev/i2c1_dev0"
                        
                        config SENSOR_DEVICE_HS300X_I2C_ADDR
                                hex "HS300x device i2c address"
                                default 0x44

                endif

                if ADD_RTTHREAD_FETURES

                endif
        endif
```

## APP_Framework/Framework/sensor/iaq/Kconfig
```kconfig
config SENSOR_TB600B_IAQ10
        bool "Using TB600B IAQ10"
        default n

        if SENSOR_TB600B_IAQ10
                config SENSOR_DEVICE_TB600B_IAQ10
                        string "tb600b iaq10 sensor name"
                        default "tb600b_iaq10_1"
                
                config SENSOR_QUANTITY_TB600B_IAQ
                        string "tb600b iaq10 quantity name"
                        default "iaq_1"
                
                if ADD_XIZI_FETURES
                        config SENSOR_TB600B_IAQ10_DRIVER_EXTUART
                                bool "Using extra uart to support tb600b iaq10"
                                default y

                        config SENSOR_DEVICE_TB600B_IAQ10_DEV
                                string "tb600b iaq10 device uart path"
                                default "/dev/uart2_dev2"
                                depends on !SENSOR_TB600B_IAQ10_DRIVER_EXTUART

                        if SENSOR_TB600B_IAQ10_DRIVER_EXTUART
                                config SENSOR_DEVICE_TB600B_IAQ10_DEV
                                        string "tb600b iaq10 device extra uart path"
                                        default "/dev/extuart_dev5"

                                config SENSOR_DEVICE_TB600B_IAQ10_DEV_EXT_PORT
                                        int "if TB600B_IAQ10 device using extuart, choose port"
                                        default "5"
                        endif
                endif

                if ADD_NUTTX_FETURES
                        config SENSOR_DEVICE_TB600B_IAQ10_DEV
                                string "tb600b iaq10 device uart path"
                                default "/dev/ttyS1"
                               ---help---
                                   If USART1 is selected, then fill in /dev/ttyS1 here.

                endif

                if ADD_RTTHREAD_FETURES

                endif                
        endif
```

## APP_Framework/Framework/sensor/pm/Kconfig
```kconfig
config SENSOR_PS5308
        bool "Using PS5308"
        default n

        if SENSOR_PS5308
                config SENSOR_DEVICE_PS5308
                        string "PS5308 sensor name"
                        default "ps5308_1"
                
                config PS5308_PM1_0
                        bool "Using pm1.0 function"
                        default n
                    
                    if PS5308_PM1_0                        
                        config SENSOR_QUANTITY_PS5308_PM1_0
                                string "PS5308 quantity PM1.0 name"
                                default "pm1_0_1"
                    endif

                config PS5308_PM2_5
                        bool "Using pm2.5 function"
                        default n
                        
                    if PS5308_PM2_5                        
                        config SENSOR_QUANTITY_PS5308_PM2_5
                                string "PS5308 quantity PM2.5 name"
                                default "pm2_5_1"
                    endif

                config PS5308_PM10
                        bool "Using pm10 function"
                        default n
                        
                    if PS5308_PM10
                        config SENSOR_QUANTITY_PS5308_PM10
                                string "PS5308 quantity PM10 name"
                                default "pm10_1"
                    endif

                if ADD_XIZI_FETURES
                        config SENSOR_PS5308_DRIVER_EXTUART
                                bool "Using extra uart to support PS5308"
                                default y

                        config SENSOR_DEVICE_PS5308_DEV
                                string "PS5308 device name"
                                default "/dev/uart2_dev2"
                                depends on !SENSOR_PS5308_DRIVER_EXTUART

                        if SENSOR_PS5308_DRIVER_EXTUART
                                config SENSOR_DEVICE_PS5308_DEV
                                        string "PS5308 device extra uart path"
                                        default "/dev/extuart_dev4"

                                config SENSOR_DEVICE_PS5308_DEV_EXT_PORT
                                        int "if PS5308 device using extuart, choose port"
                                        default "4"
                        endif
                endif

                if ADD_NUTTX_FETURES
                       config SENSOR_DEVICE_PS5308_DEV
                               string "PS5308 device name"
                               default "/dev/ttyS1"
                               ---help---
                                   If USART1 is selected, then fill in /dev/ttyS1 here.

                endif

                if ADD_RTTHREAD_FETURES

                endif
        endif
```

## APP_Framework/Framework/sensor/temperature/Kconfig
```kconfig
config SENSOR_HS300X_TEMPERATURE
        bool "Using HS300x for temperature"
        default n

        if SENSOR_HS300X_TEMPERATURE
                config SENSOR_DEVICE_HS300X
                        string "HS300x sensor name"
                        default "hs300x_1"
                
                config SENSOR_QUANTITY_HS300X_TEMPERATURE
                        string "HS300x quantity name"
                        default "temperature_1"
                
                if ADD_XIZI_FETURES
                        config SENSOR_DEVICE_HS300X_DEV
                                string "HS300x device name"
                                default "/dev/i2c1_dev0"
                                
                        config SENSOR_DEVICE_HS300X_I2C_ADDR
                                hex "HS300x device i2c address"
                                default 0x44
                endif

                if ADD_NUTTX_FETURES
                        config SENSOR_DEVICE_HS300X_DEV
                                string "HS300x device name"
                                default "/dev/i2c1_dev0"
                        
                        config SENSOR_DEVICE_HS300X_I2C_ADDR
                                hex "HS300x device i2c address"
                                default 0x44

                endif

                if ADD_RTTHREAD_FETURES

                endif
        endif
```

## APP_Framework/Framework/sensor/tvoc/Kconfig
```kconfig
config SENSOR_TB600B_TVOC10
        bool "Using TB600B TVOC10"
        default n

        if SENSOR_TB600B_TVOC10
                config SENSOR_DEVICE_TB600B_TVOC10
                        string "tb600b tvoc10 sensor name"
                        default "tb600b_tvoc10_1"
                
                config SENSOR_QUANTITY_TB600B_TVOC
                        string "tb600b tvoc10 quantity name"
                        default "tvoc_1"
                
                if ADD_XIZI_FETURES
                        config SENSOR_TB600B_TVOC10_DRIVER_EXTUART
                                bool "Using extra uart to support tb600b tvoc10"
                                default y

                        config SENSOR_DEVICE_TB600B_TVOC10_DEV
                                string "tb600b tvoc10 device uart path"
                                default "/dev/uart2_dev2"
                                depends on !SENSOR_TB600B_TVOC10_DRIVER_EXTUART

                        if SENSOR_TB600B_TVOC10_DRIVER_EXTUART
                                config SENSOR_DEVICE_TB600B_TVOC10_DEV
                                        string "tb600b tvoc10 device extra uart path"
                                        default "/dev/extuart_dev6"

                                config SENSOR_DEVICE_TB600B_TVOC10_DEV_EXT_PORT
                                        int "if TB600B_TVOC10 device using extuart, choose port"
                                        default "6"
                        endif
                endif

                if ADD_NUTTX_FETURES
                        config SENSOR_DEVICE_TB600B_TVOC10_DEV
                                string "tb600b tvoc10 device uart path"
                                default "/dev/ttyS1"
                               ---help---
                                   If USART1 is selected, then fill in /dev/ttyS1 here.

                endif

                if ADD_RTTHREAD_FETURES

                endif                
        endif
```
