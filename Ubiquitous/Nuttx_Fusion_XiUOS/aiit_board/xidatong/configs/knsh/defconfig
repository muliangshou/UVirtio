## Ubiquitous/RT-Thread_Fusion_XiUOS/micropython/Kconfig
```kconfig
menu "MicroPython"

config PKG_USING_MICROPYTHON
    bool "Enable MicroPython"
    select RT_USING_LIBC
    select RT_USING_RTC
    default n

if PKG_USING_MICROPYTHON

    menu "System Module"
        config MICROPYTHON_USING_UOS
            bool "uos: basic 'operating system' services"
            select RT_USING_DFS
            default n

        if MICROPYTHON_USING_UOS
            config MICROPYTHON_USING_FILE_SYNC_VIA_IDE
                bool "filesync: sync files through MicroPython IDE"
                default y
        endif

        config MICROPYTHON_USING_THREAD
            bool "_thread: multithreading support"
            default n

        config MICROPYTHON_USING_USELECT
            bool "uselect: wait for events on a set of streams"
            default n

        config MICROPYTHON_USING_UCTYPES
            bool "uctypes: create and manipulate C data types in Python"
            default n

        config MICROPYTHON_USING_UERRNO
            bool "uerrno: system error codes"
            default n

    endmenu

    menu "Tools Module"
        config MICROPYTHON_USING_CMATH
            bool "cmath: mathematical functions for complex numbers"
            default n

        config MICROPYTHON_USING_UBINASCII
            bool "ubinascii: binary/ASCII conversions"
            default n

		# # Module hashlib conflicts with Kendryte standalone SDK on header
        # config MICROPYTHON_USING_UHASHLIB
        #     bool "uhashlib: hashing algorithms"
        #     default n

        config MICROPYTHON_USING_UHEAPQ
            bool "uheapq: heap queue algorithm"
            default n

        config MICROPYTHON_USING_UJSON
            bool "ujson: JSON encoding and decoding"
            select MICROPYTHON_USING_UOS
            default n

        config MICROPYTHON_USING_URE
            bool "ure: simple regular expressions"
            default n

        config MICROPYTHON_USING_UZLIB
            bool "uzlib: zlib decompression"
            default n

        config MICROPYTHON_USING_URANDOM
            bool "urandom: random variable generators"
            default n
    endmenu

    menu "Network Module"
        config MICROPYTHON_USING_USOCKET
            bool "usocket: socket operations and some related functions"
            select RT_USING_SAL
            select SAL_USING_POSIX
            select RT_LWIP_IGMP
            default n

    endmenu

    menu "User Extended Module"
        config MICROPYTHON_USING_USEREXTMODS
        bool "modules define in your project"
        default n
        help
            You must provide 'qstrdefs.user.extmods.h'
            and 'moddefs.user.extmods.h'.
            Macro 'MICROPY_USER_MODULES' in 
            'moddefs.user.extmods.h' to export your modules.
    endmenu

    config PKG_MICROPYTHON_HEAP_SIZE
        int
        prompt "Heap size for python run environment"
        default 8192

    
    config MICROPYTHON_USING_FLOAT_IMPL_FLOAT
        bool "Enable micropython to use float instead of double"
        default y
        help
            In some MCU, using float can accelerate computing-speed because of the FPU.

endif

endmenu
```

## Ubiquitous/XiZi/board/aiit-arm32-board/third_party_driver/adc/Kconfig
```kconfig
menuconfig BSP_USING_ADC1
    bool "Enable ADC1"
    default n
    if BSP_USING_ADC1
        config ADC1_BUS_NAME
            string "adc 1 bus name"
            default "adc1"

        config ADC1_DRIVER_NAME
            string "adc 1 driver name"
            default "adc1_drv"

        config ADC1_DEVICE_NAME
            string "adc 1 bus device name"
            default "adc1_dev"

        config ADC1_GPIO_NUM
            int "adc 1 gpio pin num"
            default "0"
        
        config ADC1_GPIO_DEF
            string "adc 1 gpio define type"
            default "A"
    endif

menuconfig BSP_USING_ADC2
    bool "Enable ADC2"
    default n
    if BSP_USING_ADC2
        config ADC2_BUS_NAME
            string "adc 2 bus name"
            default "adc2"

        config ADC2_DRIVER_NAME
            string "adc 2 driver name"
            default "adc2_drv"

        config ADC2_DEVICE_NAME
            string "adc 2 bus device name"
            default "adc2_dev"

        config ADC2_GPIO_NUM
            int "adc 2 gpio pin num"
            default "6"
        
        config ADC2_GPIO_DEF
            string "adc 2 gpio define type"
            default "A"
    endif

menuconfig BSP_USING_ADC3
    bool "Enable ADC3"
    default n
    if BSP_USING_ADC3
        config ADC3_BUS_NAME
            string "adc 3 bus name"
            default "adc3"

        config ADC3_DRIVER_NAME
            string "adc 3 driver name"
            default "adc3_drv"

        config ADC3_DEVICE_NAME
            string "adc 3 bus device name"
            default "adc3_dev"

        config ADC3_GPIO_NUM
            int "adc 3 gpio pin num"
            default "0"
        
        config ADC3_GPIO_DEF
            string "adc 3 gpio define type"
            default "A"
    endif
```

## Ubiquitous/XiZi/board/aiit-arm32-board/third_party_driver/lcd/Kconfig
```kconfig
if BSP_USING_LCD
    config LCD_BUS_NAME
        string "lcd bus name"
        default "lcd"
    config LCD_DRV_NAME
        string "lcd bus driver name"
        default "lcd_drv"
    config LCD_DEVICE_NAME
        string "lcd bus device name"
        default "lcd_dev"   
    config BSP_LCD_X_MAX
        int "LCD Height"
        default 240
    config BSP_LCD_Y_MAX
        int "LCD Width"
        default 320
endif
```

## Ubiquitous/XiZi/board/aiit-arm32-board/third_party_driver/spi/Kconfig
```kconfig
config BSP_USING_SPI1
bool "Using spi1  "
default n

if BSP_USING_SPI1
    config SPI_BUS_NAME_1
        string "spi bus 1 name"
        default "spi1"
    config SPI_1_DRV_NAME
        string "spi bus 1 driver name"
        default "spi1_drv"
endif

config BSP_USING_SPI2
bool "Using spi2  "
default n

if BSP_USING_SPI2
    config SPI_BUS_NAME_2
        string "spi bus 2 name"
        default "spi2"
    config SPI_2_DRV_NAME
        string "spi bus 2 driver name"
        default "spi2_drv"
    menuconfig RESOURCES_SPI_LORA
    bool "Using spi lora function"
    default n
    if RESOURCES_SPI_LORA
    config SX12XX_SPI_DEVICE_NAME
        string "SX1278 lora device spi name"
        default "spi2_dev0"
    config SX12XX_DEVICE_NAME
        string "SX1278 lora device name"
        default "spi2_lora"

    config SX12XX_DEVICE_RST_PIN
        int
        default 10

    config SX12XX_DEVICE_DO0_PIN
        int
        default 10

    config SX12XX_DEVICE_DO1_PIN
        int
        default 10

    config SX12XX_DEVICE_DO2_PIN
        int
        default 10
    
    config SX12XX_DEVICE_DO3_PIN
        int
        default 10
    
    config SX12XX_DEVICE_DO4_PIN
        int
        default 10
    
    config SX12XX_DEVICE_DO5_PIN
        int
        default 10
    endif
endif

config BSP_USING_SPI3
bool "Using spi3  "
default n

if BSP_USING_SPI3
    config SPI_BUS_NAME_3
        string "spi bus 3 name"
        default "spi3"
    config SPI_3_DRV_NAME
        string "spi bus 3 driver name"
        default "spi3_drv"
endif
```

## Ubiquitous/XiZi/board/aiit-riscv64-board/third_party_driver/lcd/Kconfig
```kconfig
if BSP_USING_LCD
    config LCD_BUS_NAME
        string "lcd bus name"
        default "lcd"
    config LCD_DRV_NAME
        string "lcd bus driver name"
        default "lcd_drv"
    config LCD_DEVICE_NAME
            string "lcd bus device name"
            default "lcd_dev"   
    config BSP_LCD_CS_PIN
        int "CS pin number of 8080 interface"
        default 40
    config BSP_LCD_WR_PIN
        int "WR pin number of 8080 interface"
        default 38
    config BSP_LCD_DC_PIN
        int "DC pin number of 8080 interface"
        default 41
    config FPIOA_LCD_DC
        int "DC FPIOA number of 8080 interface"
        default 2
    config BSP_LCD_BL_PIN
        int "BL pin number of 8080 interface"
        default 47
    config FPIOA_LCD_BL
        int "BL FPIOA number of 8080 interface"
        default 10
    config BSP_LCD_X_MAX
        int "LCD Height"
        default 240
    config BSP_LCD_Y_MAX
        int "LCD Width"
        default 320
endif
```

## Ubiquitous/XiZi/board/cortex-m4-emulator/Kconfig
```kconfig
mainmenu "XiZi Project Configuration"

config BSP_DIR
    string
    option env="BSP_ROOT"
    default "."

config KERNEL_DIR
    string
    option env="KERNEL_ROOT"
    default "../.."

config BOARD_CORTEX_M4_EVB
    bool
    select  ARCH_ARM
    default y

source "$KERNEL_DIR/arch/Kconfig"

menu "cortex-m4-emulator feature"
    source "$BSP_DIR/third_party_driver/Kconfig"
    
    menu "config default board resources"
        menu "config board app name"
            config BOARD_APP_NAME
                string "config board app name"
                default "/XiUOS_cortex-m4-emulator_app.bin"
        endmenu

        menu "config board service table"
            config SERVICE_TABLE_ADDRESS
                hex "board service table address"
                default 0x20000000
        endmenu

        menu "config hardware resources for connection"
            if CONNECTION_COMMUNICATION_ETHERNET
                config ETHERNET_UART_NAME
                    string "ethernet uart name"
                    default "/dev/usart3_dev3"
            endif
            if CONNECTION_COMMUNICATION_WIFI
                config WIFI_UART_NAME
                    string "wifi uart name"
                    default "/dev/usart3_dev3"
            endif

        endmenu

    endmenu

endmenu


menu "Hardware feature"
source "$KERNEL_DIR/resources/Kconfig"
endmenu

source "$KERNEL_DIR/Kconfig"
```

## Ubiquitous/XiZi/board/cortex-m4-emulator/third_party_driver/Kconfig
```kconfig
menuconfig BSP_USING_DMA
bool "Using DMA device"
default y
if BSP_USING_DMA
source "$BSP_DIR/third_party_driver/common/Kconfig"
endif

menuconfig BSP_USING_GPIO
bool "Using GPIO device "
default y
select RESOURCES_PIN
if BSP_USING_GPIO
source "$BSP_DIR/third_party_driver/gpio/Kconfig"
endif

menuconfig BSP_USING_UART
bool "Using UART device"
default y
select RESOURCES_SERIAL
if BSP_USING_UART
source "$BSP_DIR/third_party_driver/uart/Kconfig"
endif
```

## Ubiquitous/XiZi/board/gd32vf103_rvstar/Kconfig
```kconfig
mainmenu "XiZi Project Configuration"

config BSP_DIR
    string
    option env="BSP_ROOT"
    default "."

config KERNEL_DIR
    string
    option env="KERNEL_ROOT"
    default "../.."

config BOARD_GD32VF103RVSTAR
    bool
    select  ARCH_RISCV
    default y   

source "$KERNEL_DIR/arch/Kconfig"

menu "gd32vf103_rvstar feature"
    source "$BSP_DIR/third_party_driver/Kconfig"
endmenu


menu "Hardware feature"
    source "$KERNEL_DIR/resources/Kconfig"
endmenu

source "$KERNEL_DIR/Kconfig"
```

## Ubiquitous/XiZi/board/gd32vf103_rvstar/third_party_driver/uart/Kconfig
```kconfig
menuconfig BSP_USING_UART4
    bool "Enable UART4"
    default y
    if BSP_USING_UART4
        config SERIAL_BUS_NAME_4
            string "serial bus  name"
            default "uart4"
        config SERIAL_DRV_NAME_4
            string "serial bus  driver name"
            default "uart4_drv"
        config SERIAL_4_DEVICE_NAME_4
                string "serial bus  device name"
                default "uart4_dev4"   
    endif
```

## Ubiquitous/XiZi/board/nuvoton-m2354/Kconfig
```kconfig
mainmenu "XiUOS Project Configuration"

config BSP_DIR
    string
    option env="BSP_ROOT"
    default "."

config KERNEL_DIR
    string
    option env="KERNEL_ROOT"
    default "../.."

config BOARD_NUVOTON_M2354
    bool
    select ARCH_ARM
    default y

source "$KERNEL_DIR/arch/Kconfig"

menu "nuvoton-m2354 feature"
    source "$BSP_DIR/third_party_driver/Kconfig"
    
    menu "config default board resources"
        menu "config board app name"
            config BOARD_APP_NAME
                string "config board app name"
                default "/XiUOS_nuvoton_m2354_app.bin"
        endmenu

        menu "config board service table"
            config SERVICE_TABLE_ADDRESS
                hex "board service table address"
                default 0x20000000
        endmenu

    endmenu

endmenu

menu "Hardware feature"
    source "$KERNEL_DIR/resources/Kconfig"
endmenu

source "$KERNEL_DIR/Kconfig"
```

## Ubiquitous/XiZi/board/nuvoton-m2354/third_party_driver/Kconfig
```kconfig
menuconfig BSP_USING_UART
    bool "Using UART device"
    default y
    select RESOURCES_SERIAL
    if BSP_USING_UART
        source "$BSP_DIR/third_party_driver/uart/Kconfig"
    endif
```

## Ubiquitous/XiZi/board/nuvoton-m2354/third_party_driver/uart/Kconfig
```kconfig
menuconfig BSP_USING_UART0
    bool "Enable UART0"
    default y
    if BSP_USING_UART0
        config SERIAL_BUS_NAME_0
            string "serial bus 0 name"
            default "uart0"
        config SERIAL_DRV_NAME_0
            string "serial bus 0 driver name"
            default "uart0_drv"
        config SERIAL_0_DEVICE_NAME_0
                string "serial bus 0 device name"
                default "uart0_dev0"   
    endif
```

## Ubiquitous/XiZi/board/ok1052-c/third_party_driver/Kconfig
```kconfig
menuconfig BSP_USING_LPUART
    bool "Using UART device"
    default y
    select RESOURCES_SERIAL
    if BSP_USING_LPUART
        source "$BSP_DIR/third_party_driver/uart/Kconfig"
    endif

menuconfig BSP_USING_LWIP
    bool "Using LwIP device"
    default n
    select RESOURCES_LWIP

menuconfig BSP_USING_GPIO
    bool "Using GPIO device "
    default y
    select RESOURCES_PIN

    if BSP_USING_GPIO
        source "$BSP_DIR/third_party_driver/gpio/Kconfig"
    endif

menuconfig BSP_USING_I2C
    bool "Using I2C device"
    default n
    select RESOURCES_I2C

    if BSP_USING_I2C
        source "$BSP_DIR/third_party_driver/i2c/Kconfig"
    endif

menuconfig BSP_USING_ADC
    bool "Using ADC device"
    default n
    select RESOURCES_ADC

    if BSP_USING_ADC
        source "$BSP_DIR/third_party_driver/adc/Kconfig"
    endif

menuconfig BSP_USING_SPI
    bool "Using SPI device"
    default n
    select RESOURCES_SPI

    if BSP_USING_SPI
        source "$BSP_DIR/third_party_driver/spi/Kconfig"
    endif

menuconfig BSP_USING_RTC
    bool "Using RTC device"
    default n
    select RESOURCES_RTC
    if BSP_USING_RTC
    source "$BSP_DIR/third_party_driver/rtc/Kconfig"
    endif

menuconfig BSP_USING_SEMC
    bool "Using SEMC device"
    default n
    if BSP_USING_SEMC
        source "$BSP_DIR/third_party_driver/semc/Kconfig"
    endif

menuconfig BSP_USING_SDIO
    bool "Using SD card device"
    default n
    select RESOURCES_SDIO
    if BSP_USING_SDIO
        source "$BSP_DIR/third_party_driver/sdio/Kconfig"
    endif

menuconfig BSP_USING_USB
    bool "Using USB device"
    default n
    select RESOURCES_USB
    if BSP_USING_USB
        source "$BSP_DIR/third_party_driver/usb/Kconfig"
    endif
```

## Ubiquitous/XiZi/board/ok1052-c/third_party_driver/adc/Kconfig
```kconfig
config BSP_USING_ADC1
bool "Enable ADC1"
default y
if BSP_USING_ADC1
    config ADC_BUS_NAME_1
        string "adc bus 1 name"
        default "adc1"
    config ADC_DRV_NAME_1
        string "adc bus 1 driver name"
        default "adc1_drv"
    config ADC_1_DEVICE_NAME_0
        string "adc bus 1 device name"
        default "adc1_dev"
endif

config BSP_USING_ADC2
bool "Enable ADC2"
default y
if BSP_USING_ADC2
    config ADC_BUS_NAME_2
        string "adc bus 2 name"
        default "adc2"
    config ADC_DRV_NAME_2
        string "adc bus 2 driver name"
        default "adc2_drv"
    config ADC_2_DEVICE_NAME_0
        string "adc bus 2 device name"
        default "adc2_dev"
endif
```
