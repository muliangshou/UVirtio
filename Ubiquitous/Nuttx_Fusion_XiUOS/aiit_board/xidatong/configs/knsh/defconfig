## Ubiquitous/RT-Thread_Fusion_XiUOS/aiit_board/aiit-arm32-board/Kconfig
```kconfig
mainmenu "RT-Thread Configuration"

config ROOT_DIR
    string
    default "../../../.."

config BSP_DIR
    string
    default "."

config RT_Thread_DIR 
    string
    default "../.."

config RTT_DIR
    string
    default "../../rt-thread"

config APP_DIR
    string
    default "../../../../APP_Framework"

source "$RTT_DIR/Kconfig"
source "$RTT_DIR/bsp/stm32/libraries/Kconfig"
source "board/Kconfig"
source "$RT_Thread_DIR/micropython/Kconfig"
source "$RT_Thread_DIR/app_match_rt-thread/Kconfig"
source "$ROOT_DIR/APP_Framework/Kconfig"
```

## Ubiquitous/RT-Thread_Fusion_XiUOS/aiit_board/aiit-arm32-board/board/Kconfig
```kconfig
menu"Hardware Drivers Config"

    menuconfig SOC_STM32F407ZG
        bool
        select SOC_SERIES_STM32F4
        select RT_USING_COMPONENTS_INIT
        select RT_USING_USER_MAIN
        default y

    config BSP_USING_GPIO
        bool "Enable GPIO"
        select RT_USING_PIN
        default y


    menuconfig BSP_USING_UART
        bool "Using UART device"
        default y
        select RT_USING_SERIAL
        if BSP_USING_UART
        source "$BSP_DIR/board/ports/uart/Kconfig"
        endif


    menuconfig BSP_USING_I2C1
        bool "Using I2C device"
        default n
        select  RT_USING_I2C
        select  RT_USING_I2C_BITOPS
        select  RT_USING_PIN
        if BSP_USING_I2C1
        source "$BSP_DIR/board/ports/I2c/Kconfig"
        endif

    menuconfig BSP_USING_SPI
        bool "Using SPI BUS"
        default n
        select RT_USING_SPI
        if BSP_USING_SPI
        source "$BSP_DIR/board/ports/spi/Kconfig"
        endif


    menuconfig BSP_USING_CH438
        bool "Using CH438 device"
        default y
        if BSP_USING_CH438
        source "$BSP_DIR/board/ports/ch438/Kconfig"
        endif

    menuconfig BSP_USING_USB
        bool "Using USB device"
        default n
        select BSP_USING_STM32_USBH
        select RESOURCES_USB
        select RESOURCES_USB_HOST
        select USBH_MSTORAGE
        select RESOURCES_USB_DEVICE
        if BSP_USING_USB
        source "$BSP_DIR/board/ports/usb/Kconfig"
        endif

    source "$RTT_DIR/bsp/stm32/libraries/HAL_Drivers/Kconfig"
endmenu
```

## Ubiquitous/RT-Thread_Fusion_XiUOS/aiit_board/aiit-arm32-board/board/ports/I2c/Kconfig
```kconfig
config BSP_USING_I2C1
    bool "Enable I2C1 BUS (software simulation)"
    default y
    if BSP_USING_I2C1
    config BSP_I2C1_SCL_PIN
        int "I2C scl pin number"
        range 0 143
        default 24
    config BSP_I2C1_SDA_PIN
        int "I2C sda pin number"
        range 0 143
        default 25
    endif
```

## Ubiquitous/RT-Thread_Fusion_XiUOS/aiit_board/aiit-arm32-board/board/ports/spi/Kconfig
```kconfig
config BSP_USING_SPI1
    bool "Enable SPI1 BUS"
    default n
    
config BSP_SPI1_TX_USING_DMA
    bool "Enable SPI1 TX DMA"
    depends on BSP_USING_SPI1
    default n

config BSP_SPI1_RX_USING_DMA
    bool "Enable SPI1 RX DMA"
    depends on BSP_USING_SPI1
    select BSP_SPI1_TX_USING_DMA
    default n

config BSP_USING_SPI2
    bool "Enable SPI2 BUS"
    default n

config BSP_SPI2_TX_USING_DMA
    bool "Enable SPI2 TX DMA"
    depends on BSP_USING_SPI2
    default n

config BSP_SPI2_RX_USING_DMA
    bool "Enable SPI2 RX DMA"
    depends on BSP_USING_SPI2
    select BSP_SPI2_TX_USING_DMA
    default n


config BSP_USING_SPI3
    bool "Enable SPI3 BUS"
    default n

config BSP_SPI3_TX_USING_DMA
    bool "Enable SPI3 TX DMA"
    depends on BSP_USING_SPI3
    default n

config BSP_SPI3_RX_USING_DMA
    bool "Enable SPI3 RX DMA"
    depends on BSP_USING_SPI3
    select BSP_SPI3_TX_USING_DMA
    default n
```

## Ubiquitous/RT-Thread_Fusion_XiUOS/aiit_board/aiit-arm32-board/board/ports/uart/Kconfig
```kconfig
config BSP_USING_UART1
    bool "Enable UART1"
    default y

config BSP_USING_UART2
    bool "Enable UART2"
    default n

config BSP_USING_UART3
    bool "Enable UART3"
    default n

config BSP_USING_UART4
    bool "Enable UART4"
    default n



    
```

## Ubiquitous/RT-Thread_Fusion_XiUOS/aiit_board/xidatong/board/Kconfig
```kconfig
menu "Hardware Drivers Config"

config SOC_IMXRT1052CVL5B
    bool 
    select SOC_MIMXRT1050_SERIES
    select RT_USING_COMPONENTS_INIT
    select RT_USING_USER_MAIN
    default y

menu "On-chip Peripheral Drivers"

    config BSP_USING_BOOT_IMAGE
        bool "Enable boot image"
        default y
    config BSP_USING_DMA
        bool "Enable DMA"
        default n
        
    config BSP_USING_GPIO
        bool "Enable GPIO"
        select RT_USING_PIN
        default y
    menuconfig BSP_USING_LPUART
        bool "Enable UART"
        select RT_USING_SERIAL
        default y
        
        if BSP_USING_LPUART
            config BSP_USING_LPUART1
                bool "Enable LPUART1"
                default y

                config BSP_LPUART1_RX_USING_DMA
                    bool "Enable LPUART1 RX DMA"
                    depends on BSP_USING_LPUART1
                    select BSP_USING_DMA
                    select RT_SERIAL_USING_DMA
                    default n

                    config BSP_LPUART1_RX_DMA_CHANNEL
                        depends on BSP_LPUART1_RX_USING_DMA
                        int "Set LPUART1 RX DMA channel (0-32)"
                        default 0

                config BSP_LPUART1_TX_USING_DMA
                    bool "Enable LPUART1 TX DMA"
                    depends on BSP_USING_LPUART1
                    select BSP_USING_DMA
                    select RT_SERIAL_USING_DMA
                    default n

                    config BSP_LPUART1_TX_DMA_CHANNEL
                        depends on BSP_LPUART1_TX_USING_DMA
                        int "Set LPUART1 TX DMA channel (0-32)"
                        default 1

            config BSP_USING_LPUART2
                bool "Enable LPUART2"
                default y

                config BSP_LPUART2_RX_USING_DMA
                    bool "Enable LPUART2 RX DMA"
                    depends on BSP_USING_LPUART2
                    select BSP_USING_DMA
                    select RT_SERIAL_USING_DMA
                    default n

                    config BSP_LPUART2_RX_DMA_CHANNEL
                        depends on BSP_LPUART2_RX_USING_DMA
                        int "Set LPUART2 RX DMA channel (0-32)"
                        default 2

                config BSP_LPUART2_TX_USING_DMA
                    bool "Enable LPUART2 TX DMA"
                    depends on BSP_USING_LPUART2
                    select BSP_USING_DMA
                    select RT_SERIAL_USING_DMA
                    default n

                    config BSP_LPUART2_TX_DMA_CHANNEL
                        depends on BSP_LPUART2_TX_USING_DMA
                        int "Set LPUART2 TX DMA channel (0-32)"
                        default 3

            config BSP_USING_LPUART3
                bool "Enable LPUART3"
                default y

                config BSP_LPUART3_RX_USING_DMA
                    bool "Enable LPUART3 RX DMA"
                    depends on BSP_USING_LPUART3
                    select BSP_USING_DMA
                    select RT_SERIAL_USING_DMA
                    default n

                    config BSP_LPUART3_RX_DMA_CHANNEL
                        depends on BSP_LPUART3_RX_USING_DMA
                        int "Set LPUART3 RX DMA channel (0-32)"
                        default 4

                config BSP_LPUART3_TX_USING_DMA
                    bool "Enable LPUART3 TX DMA"
                    depends on BSP_USING_LPUART3
                    select BSP_USING_DMA
                    select RT_SERIAL_USING_DMA
                    default n

                    config BSP_LPUART3_TX_DMA_CHANNEL
                        depends on BSP_LPUART3_TX_USING_DMA
                        int "Set LPUART3 TX DMA channel (0-32)"
                        default 5

            config BSP_USING_LPUART4
                bool "Enable LPUART4"
                default n

                config BSP_LPUART4_RX_USING_DMA
                    bool "Enable LPUART4 RX DMA"
                    depends on BSP_USING_LPUART4
                    select BSP_USING_DMA
                    select RT_SERIAL_USING_DMA
                    default n

                    config BSP_LPUART4_RX_DMA_CHANNEL
                        depends on BSP_LPUART4_RX_USING_DMA
                        int "Set LPUART4 RX DMA channel (0-32)"
                        default 6

                config BSP_LPUART4_TX_USING_DMA
                    bool "Enable LPUART4 TX DMA"
                    depends on BSP_USING_LPUART4
                    select BSP_USING_DMA
                    select RT_SERIAL_USING_DMA
                    default n

                    config BSP_LPUART4_TX_DMA_CHANNEL
                        depends on BSP_LPUART4_TX_USING_DMA
                        int "Set LPUART4 TX DMA channel (0-32)"
                        default 7
            
            
            config BSP_USING_LPUART8
                bool "Enable LPUART8"
                default y

                config BSP_LPUART8_RX_USING_DMA
                    bool "Enable LPUART8 RX DMA"
                    depends on BSP_USING_LPUART8
                    select BSP_USING_DMA
                    select RT_SERIAL_USING_DMA
                    default n

                    config BSP_LPUART8_RX_DMA_CHANNEL
                        depends on BSP_LPUART8_RX_USING_DMA
                        int "Set LPUART8 RX DMA channel (0-32)"
                        default 8

                config BSP_LPUART8_TX_USING_DMA
                    bool "Enable LPUART8 TX DMA"
                    depends on BSP_USING_LPUART8
                    select BSP_USING_DMA
                    select RT_SERIAL_USING_DMA
                    default n

                    config BSP_LPUART8_TX_DMA_CHANNEL
                        depends on BSP_LPUART8_TX_USING_DMA
                        int "Set LPUART8 TX DMA channel (0-32)"
                        default 9

        endif
    menuconfig BSP_USING_I2C
        bool "Enable I2C"
        select RT_USING_I2C
        default n
        if BSP_USING_I2C
            config BSP_USING_I2C1
                bool "Enable I2C1"
                default n
            choice
                prompt "Select I2C1 badurate"
                default HW_I2C1_BADURATE_100kHZ

                config HW_I2C1_BADURATE_100kHZ
                    bool "Badurate 100kHZ"

                config HW_I2C1_BADURATE_400kHZ
                    bool "Badurate 400kHZ"
            endchoice
        endif

    menuconfig BSP_USING_CAN
        bool "Enable CAN"
        select RT_USING_CAN
        default n

        if BSP_USING_CAN
            config BSP_USING_CAN1
                bool "Enable CAN1"
                default y
        endif
    
    config BSP_USING_RTC
        bool "Enable RTC"
        select RT_USING_RTC
        default n
    
    config BSP_USING_SDIO
        bool "Enable SDIO"
        default n

endmenu

menu "Onboard Peripheral Drivers"
    config BSP_USING_SDRAM
        bool "Enable SDRAM"
        default n
    config BSP_USING_SDCARD
	    bool "Using SDCard"
        select BSP_USING_SDIO
        select RT_USING_SDIO
        select RT_USING_DFS
        select RT_USING_DFS_ELMFAT
	    default n 

    menuconfig BSP_USING_ETH
	bool "Enable Ethernet"
	select RT_USING_NETDEV
	default n
	if BSP_USING_ETH
		config BSP_USING_PHY
            select RT_USING_PHY
			bool "Enable ethernet phy"
			default y

	    if BSP_USING_PHY
            config PHY_DEVICE_ADDRESS
                int "Specify address of phy device"
                default 0

            config PHY_USING_8720A
                bool "xidatong use LAN8720A phy"
                default y

            if PHY_USING_8720A
                config PHY_RESET_PORT
                    int "indicate port of reset"
                    default 1

                config PHY_RESET_PIN
                    int "indicate pin of reset"
                    default 3
            endif

        endif
	endif

endmenu


endmenu
```

## Ubiquitous/RT-Thread_Fusion_XiUOS/app_match_rt-thread/Kconfig
```kconfig
menu "More Drivers"

source "$RT_Thread_DIR/app_match_rt-thread/rw007/Kconfig"
source "$RT_Thread_DIR/app_match_rt-thread/ov2640/Kconfig"
endmenu
```

## Ubiquitous/RT-Thread_Fusion_XiUOS/app_match_rt-thread/ov2640/Kconfig
```kconfig
menuconfig DRV_USING_OV2640
	bool "ov2640 driver"
	default n
	help 
	note:
		The resolution and window size must follow the proportional relationship, 
	and the resolution value had better choose constant value(eg: 320*240), 
	otherwise the picture will be problematic

if DRV_USING_OV2640
	choice
    prompt "Output format"
    default OV2640_JPEG_MODE
	help
		Select the camera output format
    config OV2640_JPEG_MODE
            bool "jpeg mode"
    config OV2640_RGB565_MODE
        	bool "RGB565 mode"
    endchoice
	config OV2640_X_RESOLUTION_IMAGE_OUTSIZE
        int "X direction resolution of outputimage"
        default 240
	config OV2640_Y_RESOLUTION_IMAGE_OUTSIZE
		int "Y direction resolution of outputimage"
		default 240

	config OV2640_X_IMAGE_WINDOWS_SIZE
		int "X direction WINDOWS SIZE"
		default 400
		comment "the value must be greater than OV2640_X_RESOLUTION_IMAGE_OUTSIZE"
	
	config OV2640_Y_IMAGE_WINDOWS_SIZE
		int "Y direction WINDOWS SIZE"
		default 400
		comment "the value must be greater than OV2640_Y_RESOLUTION_IMAGE_OUTSIZE"
endif

if SOC_FAMILY_STM32
	config DRV_USING_OV2640
		select BSP_USING_DCMI
		config OV2640_RGB565_MODE
			select BSP_USING_MCU_LCD
endif

if BOARD_K210_EVB
	config DRV_USING_OV2640
		select BSP_USING_DVP
endif
```
