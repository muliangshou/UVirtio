## Ubiquitous/XiZi/board/ok1052-c/third_party_driver/spi/Kconfig
```kconfig
config BSP_USING_SPI1
bool "Enable SPI1"
default y
if BSP_USING_SPI1
    config SPI_1_BUS_NAME
        string "spi1 bus name"
        default "spi1"
    config SPI_1_DRV_NAME
        string "spi bus 1 driver name"
        default "spi1_drv"
    config SPI_1_DEV_NAME_0
        string "spi bus 1 device name"
        default "spi1_dev"
endif

config BSP_USING_SPI2
bool "Enable SPI2"
default y
if BSP_USING_SPI2
    config SPI_2_BUS_NAME
        string "spi2 bus name"
        default "spi2"
    config SPI_2_DRV_NAME
        string "spi bus 2 driver name"
        default "spi2_drv"
    config SPI_2_DEV_NAME_0
        string "spi bus 2 device name"
        default "spi2_dev"
endif

config BSP_USING_SPI3
bool "Enable SPI3"
default y
if BSP_USING_SPI3
    config SPI_3_BUS_NAME
        string "spi3 bus name"
        default "spi3"
    config SPI_3_DRV_NAME
        string "spi bus 3 driver name"
        default "spi3_drv"
    config SPI_3_DEV_NAME_0
        string "spi bus 3 device name"
        default "spi3_dev"
endif
```

## Ubiquitous/XiZi/board/ok1052-c/third_party_driver/usb/Kconfig
```kconfig
config BSP_USING_NXP_USBH
    bool "Using usb host by NXP library"
    default n
    if BSP_USING_NXP_USBH
        config USB_BUS_NAME
            string "usb bus name"
            default "usb"
        config USB_DRIVER_NAME
            string "usb bus driver name"
            default "usb_drv"
        config USB_DEVICE_NAME
            string "usb bus device name"
            default "usb_dev"
    endif
```

## Ubiquitous/XiZi/board/rv32m1_vega/Kconfig
```kconfig
mainmenu "XiZi Project Configuration"

config BSP_DIR
    string
    option env="BSP_ROOT"
    default "."

config KERNEL_DIR
    string
    option env="KERNEL_ROOT"
    default "../.."

config BOARD_RV32M1_VEGA
    bool
    select  ARCH_RISCV
    default y   

source "$KERNEL_DIR/arch/Kconfig"

menu "rv32m1_vega feature"
    source "$BSP_DIR/third_party_driver/Kconfig"
endmenu


menu "Hardware feature"
    source "$KERNEL_DIR/resources/Kconfig"
endmenu

source "$KERNEL_DIR/Kconfig"
```

## Ubiquitous/XiZi/board/rv32m1_vega/third_party_driver/uart/Kconfig
```kconfig
menuconfig BSP_USING_UART0
    bool "Enable UART0"
    default y
    if BSP_USING_UART0
        config SERIAL_BUS_NAME_0
            string "serial bus  name"
            default "uart0"
        config SERIAL_DRV_NAME_0
            string "serial bus  driver name"
            default "uart0_drv"
        config SERIAL_0_DEVICE_NAME_0
                string "serial bus  device name"
                default "uart0_dev0"   
    endif
```

## Ubiquitous/XiZi/board/stm32f103-nano/Kconfig
```kconfig
mainmenu "XiZi Project Configuration"

config BSP_DIR
    string
    option env="BSP_ROOT"
    default "."

config KERNEL_DIR
    string
    option env="KERNEL_ROOT"
    default "../.."

config BOARD_STM32F103_NANO
    bool
    select  ARCH_ARM
    default y

source "$KERNEL_DIR/arch/Kconfig"

menu "stm32f103-nano feature"
    source "$BSP_DIR/third_party_driver/Kconfig"
    
    menu "config default board resources"
        menu "config board app name"
            config BOARD_APP_NAME
                string "config board app name"
                default "/XiUOS_stm32f103nano_app.bin"
        endmenu

        menu "config board service table"
            config SERVICE_TABLE_ADDRESS
                hex "board service table address"
                default 0x20000000
        endmenu

    endmenu

endmenu


menu "Hardware feature"
source "$KERNEL_DIR/resources/Kconfig"
endmenu

source "$KERNEL_DIR/Kconfig"
```

## Ubiquitous/XiZi/board/stm32f407-st-discovery/third_party_driver/dac/Kconfig
```kconfig
if BSP_USING_DAC
    config DAC_BUS_NAME
        string "dac bus name"
        default "dac"

    config DAC_DRIVER_NAME
        string "dac driver name"
        default "dac_drv"

    config DAC_DEVICE_NAME
        string "dac bus device name"
        default "dac_dev"

    config DAC_GPIO_NUM
        int "dac gpio pin num(only support 4 or 5)"
        default "4"
endif
```

## Ubiquitous/XiZi/board/xidatong/third_party_driver/Kconfig
```kconfig
menuconfig BSP_USING_LPUART
    bool "Using UART device"
    default y
    select RESOURCES_SERIAL
    if BSP_USING_LPUART
        source "$BSP_DIR/third_party_driver/uart/Kconfig"
    endif

menuconfig BSP_USING_CH438
    bool "Using CH438 device"
    default n
    if BSP_USING_CH438
        source "$BSP_DIR/third_party_driver/ch438/Kconfig"
    endif

menuconfig BSP_USING_GPIO
    bool "Using GPIO device "
    default y
    select RESOURCES_PIN
    if BSP_USING_GPIO
        source "$BSP_DIR/third_party_driver/gpio/Kconfig"
    endif

menuconfig BSP_USING_LWIP
    bool "Using LwIP device"
    default n
    select RESOURCES_LWIP

menuconfig BSP_USING_SEMC
    bool "Using SEMC device"
    default n
    if BSP_USING_SEMC
        source "$BSP_DIR/third_party_driver/semc/Kconfig"
    endif

menuconfig BSP_USING_SDIO
    bool "Using SD card device"
    default n
    select RESOURCES_SDIO
    if BSP_USING_SDIO
        source "$BSP_DIR/third_party_driver/sdio/Kconfig"
    endif

menuconfig BSP_USING_USB
    bool "Using USB device"
    default n
    select RESOURCES_USB
    if BSP_USING_USB
        source "$BSP_DIR/third_party_driver/usb/Kconfig"
    endif
```

## Ubiquitous/XiZi/board/xidatong/third_party_driver/sdio/Kconfig
```kconfig
if BSP_USING_SDIO
    config SDIO_BUS_NAME
        string "sdio bus name"
        default "sdio"

    config SDIO_DRIVER_NAME
        string "sdio driver name"
        default "sdio_drv"

    config SDIO_DEVICE_NAME
        string "sdio device name"
        default "sdio_dev"

    config MOUNT_SDCARD_FS
        bool "mount cd card file system"
        default n
        select MOUNT_SDCARD

    if MOUNT_SDCARD_FS
        config MOUNT_SDCARD_FS_TYPE
            int "choose file system type : FATFS(0) LWEXT4(3)"
            default 0 
    endif
endif
```

## Ubiquitous/XiZi/board/xidatong/third_party_driver/semc/Kconfig
```kconfig
config BSP_USING_EXTSRAM
    bool "config semc extern sram"
    default n
    select MEM_EXTERN_SRAM
    if BSP_USING_EXTSRAM
        config EXTSRAM_MAX_NUM
            int "config extsram chip num"
            default 4
    endif
```

## Ubiquitous/XiZi/fs/lwext4/Kconfig
```kconfig
config CONFIG_USE_DEFAULT_CFG
    int
    default 1

config CONFIG_HAVE_OWN_OFLAGS
    int
    default 0
```
